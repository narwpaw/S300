//****************************************************************************//
//*--------------------------------------------------------------------------*//
//*                                 CEURON                                   *//                     
//*--------------------------------------------------------------------------*//
//*--------------------------------------------------------------------------*//
//*  Nazwa pliku                  : LCD.c                                    *//
//*  Opis                         : Plik obs³ugi wyœwietlacza LCD            *//
//*  Autor                        : Pawe³ Narwojsz                           *//
//*  Data utrzorzenia             : 15.09.2007                               *//
//*  Data ostatniej modyfikacji   : --.--.----                               *//
//*--------------------------------------------------------------------------*//
//*                                                                          *//
//*--------------------------------------------------------------------------*//
//* Rejestr zmian  (data - opis):                                            *//
//*                                                                          *//
//*                               Brak zmian                                 *//
//*                                                                          *//
//*__________________________________________________________________________*// 
//****************************************************************************//
//****************************************************************************//







// Pliki do³¹czane -------------------------------------------------------------
     #include "common.h"
     #include "core/device.h"                                                   //aduje bibliotreki dla odpowiedniego procesora
     //#include "AT91SAM7S256.h"
     #include "core/trace.h"
     #include "LCD.h"
     #include "Framework.h "
     #include <stdarg.h>

//-----------------------Koniec plików do³¹czanych -----------------------------

#ifdef _LCD_NEGATIV_OLD_
#define LCD_delay 40

//Zmienne globalne -------------------------------------------------------------
  _Correct korekta_Y=1;
  _Correct korekta_X=1;
//___________________________Koniec zmiennych globalnych________________________


extern void Delay (unsigned long a);
//extern MenuPaint(void);
extern long long int g_counter;
extern int MenuLevel;
extern char AlarmOn; 
extern char g_info;
//Definicje --------------------------------------------------------------------
      AT91PS_PIO    m_pPio   = AT91C_BASE_PIOA;
      AT91PS_PIO    TS_pPio  = AT91C_BASE_PIOA;
      //TouchScreen

#define  TS_ADC             AT91C_BASE_PDC_ADC
#define  TS_ADC_CH0         AT91C_ADC_CH0
#define  TS_ADC_CH1         AT91C_ADC_CH1
#define  TS_ADC_CH2         AT91C_ADC_CH2
#define  TS_ADC_CH3         AT91C_ADC_CH3
#define  TS_PIO             AT91C_BASE_PIOA
#define  TS_PIO_CH0         AT91C_PIO_PA17
#define  TS_PIO_CH1         AT91C_PIO_PA18
#define  TS_PIO_CH2         AT91C_PIO_PA19
#define  TS_PIO_CH3         AT91C_PIO_PA20

#define  TS_ADC_ID         AT91C_ID_ADC        
// Leds
//___________________________Koniec definicji___________________________________


      
extern signed short X_down;
extern signed short Y_down;
extern signed short X_up;
extern signed short Y_up;


char LCD_Canvas[8][128] = {
                  {254,1,1,1,1,1,1,1,131,69,125,69,41,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6,252},
                  {255,164,160,144,160,164,24,0,66,66,66,66,66,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254,255},
                  {255,148,148,148,148,148,99,0,130,68,124,68,40,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255,255},
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                  {255,192,128,128,128,128,128,140,158,191,191,128,128,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127,63}
                  };





//===================================================================================================================================================================//
//===================================================================================================================================================================//
//===================================================================================================================================================================//
//===================================================================================================================================================================//
//============================================================      F U N K C J E      ==============================================================================//
//===================================================================================================================================================================//
//===================================================================================================================================================================//



//*-----------------------------------------------------------------------------
//* Nazwa funkcji :    RepaintLCD
//* Funkcja g³ówna wyrysowywania tabeli LCD_Canvas na ekran LCD
//*-----------------------------------------------------------------------------
//* Konieczne zdefiniowanie zmiennej globalnej "char LCD_Canvas[8][128];"
//*-----------------------------------------------------------------------------

char chipSelect=1;
void RepaintLCD(void)
{
  

char lcdData=0;
//char lcdStartPage=0;
//char chipSelect=0;
char displayY=0;
  
//  for (char chipSelect=1; chipSelect<=2; chipSelect++)
//{

   if (chipSelect<2) {chipSelect=2;} else {chipSelect=1;}
     at91ChipSelect(chipSelect);   

     at91DisplayYAdress(displayY);
     Delay(50);  
     
      for (char lcdStartPage=0; lcdStartPage<8; lcdStartPage++)
      {
         
        at91DisplayStartPage(lcdStartPage); 
        Delay(50);
        for (lcdData=(64*chipSelect-64); lcdData<(64*chipSelect); lcdData++)
        {
          
          at91DisplayData(LCD_Canvas[lcdStartPage][lcdData]);
          Delay(50);
        }
      }
 //}

}//_______________________ Koniec funkcji RepaintLCD __________________________






//*-----------------------------------------------------------------------------
//* Nazwa funkcji :    CleanCanvas
//* Funkcja czyszczenia bufora ekranu. 
//*-----------------------------------------------------------------------------
//* Efekt widoczny po odœwierzeniu LCD (RepaintLCD)
//*-----------------------------------------------------------------------------
void CleanCanvas(void)
{
  for (int i=0; i<=7; i++)
  {
    for (int j=0; j<=127; j++)
    {
      LCD_Canvas[i][j] =0; 
    }
  }
}//_______________________ Koniec funkcji CleanCanvas __________________________





//*-----------------------------------------------------------------------------
//* Nazwa funkcji :    HalfCleanCanvas
//* Funkcja szatkowania bufora ekranu. 
//*-----------------------------------------------------------------------------
//* Efekt widoczny po odœwierzeniu LCD (RepaintLCD)
//*-----------------------------------------------------------------------------
void HalfCleanCanvas(void)
{
  for (int i=0; i<=7; i++)
  {
    for (int j=0; j<=127; j++)
    {
      if ((j+i)%2) 
      {
        LCD_Canvas[i][j] &=0xAA; 
      }
      else
      {
        LCD_Canvas[i][j] &=0x55; 
      } 
    }
  }
}//_______________________ Koniec funkcji HalfCleanCanvas __________________________



//*-----------------------------------------------------------------------------
//* Nazwa funkcji :    CleanCanvasArea
//* Funkcja czyszczenia okreœlonego obszaru
//* Colour  -  0= bia³y, 1=czarny
//*-----------------------------------------------------------------------------
//* Efekt widoczny po odœwierzeniu LCD (RepaintLCD)
//*-----------------------------------------------------------------------------
void CleanCanvasArea(char X, char Y, char X_Lenght, char Y_Lenght, char Colour)
{

  char kol=0;
  char bit=0;
  char linia=Y;
  
if ( Colour == 0 )
{
  for (int i=0; i<=Y_Lenght-1; i++)
   { 
     kol=(X)/8;
     bit=(X)%8;
     

    
     for (int j=0; j<=X_Lenght-1; j++)
      {
           LCD_Canvas[kol][linia] &=~(1<<bit);  
           if (bit<7)  { bit++;}  else {bit=0;   kol++;  }
      }   
      linia++;
   }
}
else
{
  for (int i=0; i<=Y_Lenght-1; i++)
   { 
     kol=(X)/8;
     bit=(X)%8;
     
     for (int j=0; j<=X_Lenght-1; j++)
      {
           LCD_Canvas[kol][linia] |=(1<<bit);  
           if (bit<7)  { bit++;}  else {bit=0;   kol++;  }
      }   
      linia++;
   }
}
  
}//_______________________ Koniec funkcji CleanCanvasArea __________________________




//*-----------------------------------------------------------------------------
//* Nazwa funkcji :    CleanCanvasArea
//* Funkcja czyszczenia okreœlonego obszaru
//* Colour  -  0= bia³y, 1=czarny
//*-----------------------------------------------------------------------------
//* Efekt widoczny po odœwierzeniu LCD (RepaintLCD)
//*-----------------------------------------------------------------------------
void CanvasPixel(char X, char Y, char Colour)
{
     char kol=(X)/8;
     char bit=(X)%8;
     
     if ( Colour == 0 )
     {
       LCD_Canvas[kol][Y] &=~(1<<bit); 
     }
     else
     {
       LCD_Canvas[kol][Y] |=(1<<bit);  
     }
}//_______________________ Koniec funkcji CleanCanvasArea __________________________






//*-----------------------------------------------------------------------------
//* Nazwa funkcji :    CopyToCanvas
//* Funkcja kopiowania dowolnej tablicy[8][128] do bufora wyœwietlacza 
//*-----------------------------------------------------------------------------
//* Efekt widoczny po odœwierzeniu LCD (RepaintLCD)
//*-----------------------------------------------------------------------------
void CopyToCanvas(char Tabela[8][128])
{
  for (int i=0; i<=7; i++)
  {
    for (int j=0; j<=127; j++)
    {
      LCD_Canvas[i][j] =Tabela[i][j]; 
    }
  }
}//_______________________ Koniec funkcji CopyToCanvas __________________________






//*-----------------------------------------------------------------------------
//* Nazwa funkcji :    CopyToCanvas
//* Funkcja kopiowania dowolnej tablicy[8][128] do bufora wyœwietlacza 
//*-----------------------------------------------------------------------------
//* Efekt widoczny po odœwierzeniu LCD (RepaintLCD)
//*-----------------------------------------------------------------------------
void CopyToCanvasPoint(char *Tabela, char X, char Y, char X_Lenght, char Y_Lenght)
{

  char kol=0;
  char bit=0;
  char kol2=0;
  char bit2=0;
  char linia=Y;
  
  for (int i=0; i<=Y_Lenght-1; i++)
   {

     
     kol=(X)/8;
     bit=(X)%8;
     
     kol2=0;
     bit2=0;
       
     for (int j=0; j<=X_Lenght-1; j++)
      {
         if (((Tabela[(kol2*Y_Lenght)+(i)]>>bit2)&0x1)>0)
          {
             
             LCD_Canvas[kol][linia] |=(1<<bit); 
          }
          else
          {
             LCD_Canvas[kol][linia] &=~(1<<bit);  
          }
         
  
           if (bit<7)  { bit++;}  else {bit=0;   kol++;  }
           if (bit2<7) { bit2++;} else {bit2=0;  kol2++; }           
      }   
     
      linia++;
   }

}//_______________________ Koniec funkcji CopyToCanvas __________________________




//*-----------------------------------------------------------------------------
//* Nazwa funkcji :    at91DisplayOnOff
//* Funkcja za³¹czania/wy³¹czania LCD
//*-----------------------------------------------------------------------------
//////////////////////////////////////////////////////
// R/W  D/I  DB7  DB6  DB5  DB4  DB3  DB2  DB1  DB0 //
//  RW   DI  DB7  DB6  DB5  DB4  DB3  DB2  DB1  DB0 //
//   0    0    0    0    1    1    1    1    1    D //
//                                                  //
// on_off - "0" - OFF                               //
//        - "1" - ON                                //
//////////////////////////////////////////////////////
//*-----------------------------------------------------------------------------

 void at91DisplayOnOff(char on_off)
 {
    m_pPio->PIO_SODR =  LCD_BUS_MASK;                         // zeruje piny

   
    //m_pPio->PIO_CODR = DB5 | DB4 | DB3 | DB2 | DB1 | on_off << 3;  // "1" na wyœwietlaczu
   if (on_off)
   {
      m_pPio->PIO_CODR = DB5 | DB4 | DB3 | DB2 | DB1 | DB0;  // "1" na wyœwietlaczu
   }
   else
   {
      m_pPio->PIO_CODR = DB5 | DB4 | DB3 | DB2 | DB1;  // "1" na wyœwietlaczu 
   }
   
   m_pPio->PIO_SODR = DI;
    m_pPio->PIO_CODR = ENABLE;
    Delay(2);
    m_pPio->PIO_SODR = ENABLE;
   m_pPio->PIO_SODR =  LCD_BUS_MASK;                         // "0" na wyœwietlaczu

}//_______________________ Koniec funkcji at91DisplayOnOff ______________________
 
 





 
//*-----------------------------------------------------------------------------
//* Nazwa funkcji :    at91DisplayStartLine
//* Funkcja ustawienia lini startowej
//*-----------------------------------------------------------------------------
//////////////////////////////////////////////////////
// R/W  D/I  DB7  DB6  DB5  DB4  DB3  DB2  DB1  DB0 //
//  RW   DI  DB7  DB6  DB5  DB4  DB3  DB2  DB1  DB0 //
//   0    0    1    1    A    A    A    A    A    A //
//                                                  //
// AAAAAA - przesuniêcie w górê strony testowej     //
//////////////////////////////////////////////////////
//*-----------------------------------------------------------------------------
 void at91DisplayStartLine(void)
 {
   m_pPio->PIO_SODR =  LCD_BUS_MASK;                         // zeruje piny

   
    m_pPio->PIO_CODR =  DB7 | DB6 ;  // "1" na wyœwietlaczu
    m_pPio->PIO_SODR = DI ;
    m_pPio->PIO_CODR = ENABLE;
    Delay(2);
    m_pPio->PIO_SODR = ENABLE;
    m_pPio->PIO_SODR =  LCD_BUS_MASK;                         // "0" na wyœwietlaczu

}//_____________________ Koniec funkcji at91DisplayStartLine ___________________








 
//*-----------------------------------------------------------------------------
//* Nazwa funkcji :    at91DisplayStartPage
//* Funkcja ustawienia strony
//*-----------------------------------------------------------------------------
//////////////////////////////////////////////////////
// R/W  D/I  DB7  DB6  DB5  DB4  DB3  DB2  DB1  DB0 //
//  RW   DI  DB7  DB6  DB5  DB4  DB3  DB2  DB1  DB0 //
//   0    0    1    0    1    1    1    A    A    A //
//                                                  //
// AAA - numer zapisywanej strony                   //
//////////////////////////////////////////////////////
//*-----------------------------------------------------------------------------

 void at91DisplayStartPage(char lcd_start_page)
 {
    char data=lcd_start_page; 
    
    m_pPio->PIO_SODR =  LCD_BUS_MASK;                         // zeruje piny

      
    //m_pPio->PIO_CODR = DB7 | DB5 | DB4 | DB3 | lcd_start_page << 3;  // "1" na wyœwietlaczu
    m_pPio->PIO_CODR = DB7 | DB5 | DB4 | DB3 | (((data>>2)&0x1)<<mDB2) | (((data>>1)&0x1)<<mDB1) | (((data>>0)&0x1)<<mDB0) ;  // "1" na wyœwietlaczu
    m_pPio->PIO_SODR = DI ;
    m_pPio->PIO_CODR = ENABLE;
    Delay(LCD_delay);
    m_pPio->PIO_SODR = ENABLE;
   m_pPio->PIO_SODR =  LCD_BUS_MASK;                         // "0" na wyœwietlaczu

}//_____________________ Koniec funkcji at91DisplayStartPage ___________________









//*-----------------------------------------------------------------------------
//* Nazwa funkcji :    at91DisplayYAdress
//* Funkcja okreœla wspó³rzêdne X od których ma zacz¹æ 
//*         zapisywaæ, automatycznie inkrementowane    
//*         po kazdej operacji zapisu/odczytu
//*-----------------------------------------------------------------------------      
//////////////////////////////////////////////////////
// R/W  D/I  DB7  DB6  DB5  DB4  DB3  DB2  DB1  DB0 //
//  RW   DI  DB7  DB6  DB5  DB4  DB3  DB2  DB1  DB0 //
//   0    0    0    1    A    A    A    A    A    A //
//                                                  //
// AAAAAA-przesuniêcie zapisywanej kolumny w prawo  //
//////////////////////////////////////////////////////
//*-----------------------------------------------------------------------------

 void at91DisplayYAdress(char display_Y)
 {
   char data=(0x3F-display_Y); 
   
   m_pPio->PIO_SODR =  LCD_BUS_MASK;                         // zeruje piny


    m_pPio->PIO_CODR = DB6 | (((display_Y>>5)&0x1)<<mDB5) | (((display_Y>>4)&0x1)<<mDB4) | (((display_Y>>3)&0x1)<<mDB3) | (((display_Y>>2)&0x1)<<mDB2) | (((display_Y>>1)&0x1)<<mDB1) | (((display_Y>>0)&0x1)<<mDB0);             // "0" na wyœwietlaczu // "1" na wyœwietlaczu
    m_pPio->PIO_SODR = DI | (((data>>5)&0x1)<<mDB5) | (((data>>4)&0x1)<<mDB4) | (((data>>3)&0x1)<<mDB3) | (((data>>2)&0x1)<<mDB2) | (((data>>1)&0x1)<<mDB1) | (((data>>0)&0x1)<<mDB0);             // "0" na wyœwietlaczu
    
    m_pPio->PIO_CODR = ENABLE;
    Delay(1);
    m_pPio->PIO_SODR = ENABLE;
    m_pPio->PIO_SODR =  LCD_BUS_MASK;                       // "0" na wyœwietlaczu
}//_______________________ Koniec funkcji at91DisplayYAdress ___________________

 
 

 



//*-----------------------------------------------------------------------------
//* Nazwa funkcji :    at91DisplayData
//* Funkcja wpisywania danych do Ram LCD
//*-----------------------------------------------------------------------------
//* R/W  D/I  DB7  DB6  DB5  DB4  DB3  DB2  DB1  DB0 
//*  RW   DI  DB7  DB6  DB5  DB4  DB3  DB2  DB1  DB0 
//*  0    1    A    A    A    A    A    A    A    A 
//*                                                  
//*  AAAAAAAA - dane                                  
//*-----------------------------------------------------------------------------

inline void at91DisplayData(char lcd_data)
 {

   char data=(0xFF-lcd_data); 
   m_pPio->PIO_SODR =  LCD_BUS_MASK;                         // zeruje piny
   
      m_pPio->PIO_CODR = DI | (((lcd_data>>7)&0x1)<<mDB7) | (((lcd_data>>6)&0x1)<<mDB6) | (((lcd_data>>5)&0x1)<<mDB5) | (((lcd_data>>4)&0x1)<<mDB4) | (((lcd_data>>3)&0x1)<<mDB3) | (((lcd_data>>2)&0x1)<<mDB2) | (((lcd_data>>1)&0x1)<<mDB1) | (((lcd_data>>0)&0x1)<<mDB0); 
      m_pPio->PIO_SODR = (((data>>7)&0x1)<<mDB7) | (((data>>6)&0x1)<<mDB6) | (((data>>5)&0x1)<<mDB5) | (((data>>4)&0x1)<<mDB4) | (((data>>3)&0x1)<<mDB3) | (((data>>2)&0x1)<<mDB2) | (((data>>1)&0x1)<<mDB1) | (((data>>0)&0x1)<<mDB0); 
   

    
   m_pPio->PIO_CODR = ENABLE;

    Delay(18);
    m_pPio->PIO_SODR = ENABLE;

   // m_pPio->PIO_SODR =  LCD_BUS_MASK;                         // zeruje piny

}//_______________________ Koniec funkcji at91DisplayData ______________________


 
 
 
//*-----------------------------------------------------------------------------
//* Nazwa funkcji :    at91ChipSelect
//* Funkcja wyboru kontrolera 1z2
//*-----------------------------------------------------------------------------
//* chip_select - "1" - CS1                   
//*             - "2" - CS2      
//*-----------------------------------------------------------------------------

 void at91ChipSelect(char chip_select)
 {
   unsigned long cs_set;
   unsigned long cs_clr;
   
   m_pPio->PIO_SODR =  LCD_BUS_MASK;                         // zeruje piny

   
   if (chip_select==2) 
      {
        cs_set=CS2;
        cs_clr=CS1;
      }
 
   if (chip_select==1) 
      {
        cs_set=CS1;
        cs_clr=CS2;
      }
   


   
    m_pPio->PIO_SODR = cs_clr;   
    m_pPio->PIO_CODR = cs_set;                           // "1" na wyœwietlaczu
    
    
    
at91DisplayOnOff(1); 
  
  

}//_______________________ Koniec funkcji at91ChipSelect __________________________

 
 





//*-----------------------------------------------------------------------------
//* Nazwa funkcji :    ReadTP
//* Funkcja obs³ugi TouchPanel`a
//*-----------------------------------------------------------------------------
//*  !!! Czas trwania funkcji 15us
//*-----------------------------------------------------------------------------

void ReadTP(_TPoint *Point)
{
  unsigned pomX, pomY;
  pomX=0;
  pomY=0;

    //POMIAR X -------------------------------------------------------------------
  AT91F_PIO_CfgOutput(TS_PIO, TS_PIO_CH1);
  AT91F_PIO_CfgOutput(TS_PIO, TS_PIO_CH3);
 
  AT91F_PIO_CfgInput(TS_PIO, TS_PIO_CH0);
  TS_PIO->PIO_PPUDR=TS_PIO_CH0;
  
  TS_pPio->PIO_SODR = TS_PIO_CH1; 
  TS_pPio->PIO_CODR = TS_PIO_CH3;         
    
  pomX =  ReadADC(2);
  

  
  //POMIAR Y -------------------------------------------------------------------
  AT91F_PIO_CfgOutput(TS_PIO, TS_PIO_CH0);
  AT91F_PIO_CfgOutput(TS_PIO, TS_PIO_CH2);
  
  AT91F_PIO_CfgInput(TS_PIO, TS_PIO_CH3);
  TS_PIO->PIO_PPUDR=TS_PIO_CH3;
  
  TS_pPio->PIO_SODR = TS_PIO_CH2; 
  TS_pPio->PIO_CODR = TS_PIO_CH0;        
  
  
  pomY =  ReadADC(1);

  //walidacja / wykrycie dotkniêcia
  if ((pomY>900) || (pomY<=0) || (pomX>900) || (pomX<=0) )
  {
    pomY=0;
    pomX=0;
  }

  //kalibracja -----------------------------------------------------------------


  //przepisanie pomiarów
  Point->y=pomY;
  Point->x=pomX;
}
//END Touth panel ----------------------------------------------------------  






//*-----------------------------------------------------------------------------
//* Nazwa funkcji :    ReadADC
//*-----------------------------------------------------------------------------
//*-----------------------------------------------------------------------------
    unsigned short odp=0; 

unsigned short ReadADC (char Channel) 
{ 

 

    //enable channel and set PIN to ADCx function (no need to write PIO!!) 
  AT91C_BASE_ADC->ADC_CR = AT91C_ADC_SWRST; 
AT91C_BASE_ADC->ADC_MR = (15<24)|(11<<16)|(4<<8); 
AT91C_BASE_ADC->ADC_CHDR =0xFF;   
  
  //AT91C_BASE_ADC->ADC_CHDR =0xFF; 
    AT91C_BASE_ADC->ADC_CHER = (1<< Channel);    
    

    //start first conversion 
    AT91C_BASE_ADC->ADC_CR = AT91C_ADC_START; 
 
    while ((AT91C_BASE_ADC->ADC_SR &(1 << Channel))==0){};
    //while ((AT91C_BASE_ADC->ADC_SR & AT91C_ADC_DRDY)==0){};

      switch (Channel){
        case 0: odp=AT91C_BASE_ADC->ADC_CDR0; break; 
        case 1: odp=AT91C_BASE_ADC->ADC_CDR1; break;  
        case 2: odp=AT91C_BASE_ADC->ADC_CDR2; break;  
        case 3: odp=AT91C_BASE_ADC->ADC_CDR3; break;  
        case 4: odp=AT91C_BASE_ADC->ADC_CDR4; break;  
        case 5: odp=AT91C_BASE_ADC->ADC_CDR5; break;  
      } 
      
      
 while ((AT91C_BASE_ADC->ADC_SR &(1 << Channel))==1){};
     
     // odp=AT91C_BASE_ADC->ADC_LCDR;


      
     // AT91C_BASE_ADC->ADC_CR = AT91C_ADC_SWRST; 
      
     // AT91C_BASE_ADC->ADC_CHDR = (1<< Channel);
    return odp;
}
//*-----------------------------------------------------------------------------   
   


//*-----------------------------------------------------------------------------
//* Nazwa funkcji :    InitTS
//* Funkcja inicjalizacji obs³ugi touchopanel`a
//*-----------------------------------------------------------------------------
//*-----------------------------------------------------------------------------
void Init_LCD_TS(void) 
{ 
//LCD panel ----------------------------------------------------------  
 AT91F_PIO_ClearOutput(LCD_PIO,(unsigned int)LightLCD);
  AT91F_PIO_CfgOutput(LCD_PIO,(unsigned int)LightLCD);      //AT91PS_PIO pPio, unsigned int pioEnable

  at91DisplayOnOff(1);     // 0-OFF, 1-ON   
  at91DisplayStartPage(0);
  at91DisplayStartLine();  // set start line 
   //  at91DisplayStartPage(0);
   //at91DisplayYAdress(0);
  
//Touth panel ----------------------------------------------------------   
   
AT91C_BASE_PIOA->PIO_PPUDR|= TS_PIO_CH0;    //Pull-up enable enable reg.
AT91C_BASE_PIOA->PIO_PPUDR|= TS_PIO_CH1;    //Pull-up enable enable reg.
AT91C_BASE_PIOA->PIO_PPUDR|= TS_PIO_CH2;    //Pull-up enable enable reg.
AT91C_BASE_PIOA->PIO_PPUDR|= TS_PIO_CH3;    //Pull-up enable enable reg.
  
AT91C_BASE_ADC->ADC_MR = (3<24)|(11<<16)|(4<<8); 

}//_______________________ Koniec funkcji InitTS __________________________











const char Arial_7[101][10] = {
                  {7,127,127,62,62,62,28,28,8,8},        //30   ""
                  {7,8,8,28,28,62,62,62,127,127},        //31   ""
                  {0,0,0,0,0,0,0,0,0,0},        //32   " "
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                  {7,0,28,34,65,73,73,42,8,0}  //130 OnOff
                  };



const unsigned short Arial_18[100][26] = {
 {16,0,0,0,32771,32771,32771,32771,32771,32771,32771,32771,32771,32771,32771,32771,32771,32771,32771,32771,32771,32771,32771,0,0,0},        //30   ""
                  {16,0,0,0,32771,32771,32771,32771,32771,32771,32771,32771,32771,32771,32771,32771,32771,32771,32771,32771,32771,32771,32771,0,0,0},        //31   ""
                  {0,0,0,0,0,0,0,0,0,0,0,0,0,0,0,0,0,0,0,0,0,0,0,0,0,0},        //32   " "
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                  {15,0,0,0,2032,8188,16382,15934,31775,30735,30735,30735,30735,30751,32319,16383,8191,2031,15,15,30751,31774,15934,16380,8184,2032},        //54   "6"
                  //{16,65535,65535,65535,65527,65535,65535,65535,65535,65535,65535,65535,65535,65535,65535,65471,65535,65407,65535,65279,65535,65535,65535,65534,65534,65534},        //55   "7"
                 // 0,0,0,0,120,120,120,120,120,240,240,240,224,224,224,192,192,128,128,   0,0,0,255,255,255,255},
                  {14,0,0,0,120,120,120,120,120,240,240,240,224,224,480,448,960,896,1920,1792,3840, 7680,16383,16383,16383,16383},
                 //{0,0,0,0,0,    0,  0,  0,  0,  0,  0,  0,  0,  1,  1,  1,  3,  3,  7,  7, 15,30,63 ,63 , 63, 63},
                  {16,0,0,0,2032,8188,16382,32319,31775,63503,63503,63503,30735,31775,32318,16380,4088,8188,15934,31774,31775,31775,15934,16382,8188,2032},        //56   "8"
                  {15,0,0,0,1016,4092,8190,16190,15903,31759,31744,30720,31736,32764,32766,32319,31775,30735,30735,30735,30735,31775,15935,8190,4092,2032},        //57   "9"
                  {5,0,0,0,31,31,31,0,0,0,0,0,0,0,0,0,0,31,31,31,0,0,0,0,0,0},        //58   ":"
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                  {16,0,0,0,0,0,0,0,0,0,0,15873,32643,65511,59391,49662,32892,0,0,0,0,0,0,0,0,0},        //126   "~"
                  //{16,0,0,0,32771,32771,32771,32771,32771,32771,32771,32771,32771,32771,32771,32771,32771,32771,32771,32771,32771,32771,32771,0,0,0},        //127   ""
                  {8,0,0,0,0,0,0,0,0,0,0,0,0,0,56,124,110,6,6,110,124,56,2,5,2},  //127   "*C"
                  {16,0,0,0,32704,65520,65528,57596,126,62,30,31,16383,16383,15,15,16383,32767,31,31,62,126,57596,65528,65520,32640},        //128   "€"
                  {16,0,0,0,32771,32771,32771,32771,32771,32771,32771,32771,32771,32771,32771,32771,32771,32771,32771,32771,32771,32771,32771,0,0,0},        //129   "�"
                  };


//*-----------------------------------------------------------------------------
//* Nazwa funkcji :    Label
//* Funkcja wrysowania napisu
//*-----------------------------------------------------------------------------
//*  Vstring    - wskaŸnik do tablicy znaków
//*  alig       - wyrównanie -0=do lewej, 1=do prawej, 2=wyœrodkowany
//*  X          - wspó³¿êdna X zale¿na od wyrównania 
//*  Y          - wspó³¿êdna Y do³u napisu
//*  maxChar    - maksymalna d³ugoœæ napisu w znakach 
//*  clean      - d³ugoœæ (w pikselach) obszaru czyszczenia t³a 
//*  minY, maxY - obszar roboczy
//*  negatyw    - 0-brak, 1-negatyw
//*  funkcja zwraca d³ugoœæ napisu w pikselach
//*-----------------------------------------------------------------------------

char Label (char *Vstring, char alig, char X, int Y, char maxChar, char clean, char minY, char maxY, char negatyw) 
{ 
  //char offset=43;
  char offset=30;
  
  
  int kol=0;
  char linia=0;
  char bit=0;
  char ill_znak=0;
  
  char pocz_X=X;
  
  kol=X/8;
  bit=X%8;
  linia=Y;
   
  char dlugosc=0;
  char clean_offset=0;
  
  

  
  
  
  if (alig==1)
  {
    do {       
       
       if (Vstring[ill_znak]>=offset)  
        {
          dlugosc += Arial_7[Vstring[ill_znak]-offset][0];
        }
       else
       {
         dlugosc++;
         dlugosc++;
         dlugosc++;
       }
       dlugosc++;
       ill_znak++;
      } while ((Vstring[ill_znak]) && (ill_znak<maxChar) && (X-dlugosc>=0) );
 
    clean_offset=clean;
  }
  else
  {
    do {   
       
       
       if (Vstring[ill_znak]>=offset)  
        {
          dlugosc += Arial_7[Vstring[ill_znak]-offset][0];
        }
       else
       {
         dlugosc++;
         dlugosc++;
         dlugosc++;
       }
       
       
       dlugosc++;
       ill_znak++;
     } while ((Vstring[ill_znak]) && (ill_znak<maxChar) && (X+dlugosc<=64));
    
  }
    
  dlugosc--;
  
   //Czyszczenie obszaru ----------------------
  linia=Y;
  for (int i=1; i<=9; i++)
   {
    if ((linia>=minY) && (linia<=maxY))
    {
     kol=(X-clean_offset)/8;
     bit=(X-clean_offset)%8;
       
      for (int j=0; j<=clean; j++)
      {
        LCD_Canvas[kol][linia] &=~(1<<bit);
        
        if (bit<7) { bit++;} else {bit=0;  kol++; }
      }   


   }
    linia++;
  }
  //------------------------------------------------------
    
  if (alig==1)
  {  
    X-=dlugosc;
  }  
 
  if (alig==2)
  {  
    X+=(clean-dlugosc)/2;
    
    if (((clean-dlugosc)%2)>0) X++;
  }  

    
  //wklejanie napisu do LCD_Canvas ----------------------
  linia=Y;
  for (int i=1; i<=9; i++)
   {
    if ((linia>=minY) && (linia<=maxY))
    {
     kol=X/8;
     bit=X%8;
    for (int k=0; k<=(ill_znak-1); k++)
    {     
      
      if ((Vstring[k]>=offset) &&  (Vstring[k]!=32))
      {
        for (int j=0; j<=Arial_7[Vstring[k]-offset][0]; j++)
        {
            LCD_Canvas[kol][linia] |= (((Arial_7[Vstring[k]-offset][i])>>j)&0x1)<<bit;
            if (bit<7) { bit++;} else {bit=0;  kol++; } 
        }
      }
      else 
      {
           if (bit<7) { bit++;} else {bit=0;  kol++; } 
           if (bit<7) { bit++;} else {bit=0;  kol++; } 
           if (bit<7) { bit++;} else {bit=0;  kol++; } 

      }
      
      
    }
   }
    linia++;
  }
  //------------------------------------------------------
    

  //negatyw obszaru ----------------------
 if (negatyw)
 {
  linia=Y;
  for (int i=1; i<=9; i++)
   {
    if ((linia>=minY) && (linia<=maxY))
    {
     
     kol=(pocz_X-clean_offset)/8;
     bit=(pocz_X-clean_offset)%8;
       
      for (int j=0; j<=clean; j++)
      {
       
        if (((LCD_Canvas[kol][linia]>>bit)&0x1)>0)
        {
           LCD_Canvas[kol][linia] &=~(1<<bit);   
          
        }
        else
        {
          LCD_Canvas[kol][linia] |=(1<<bit); 
          
        }
        
        
        
        if (bit<7) { bit++;} else {bit=0;  kol++; }
      }   


   }
    linia++;
  }
  }
  //------------------------------------------------------
   
 return dlugosc;
  
}//_______________________ Koniec funkcji Label __________________________








//*-----------------------------------------------------------------------------
//* Nazwa funkcji :    LabelLength
//* Funkcja wrysowania napisu
//*-----------------------------------------------------------------------------
//*  Vstring    - wskaŸnik do tablicy znaków
//*  maxChar    - maksymalna d³ugoœæ napisu w znakach 
//*  funkcja zwraca d³ugoœæ napisu w pikselach
//*-----------------------------------------------------------------------------

char LabelLength (char *Vstring, char maxChar)
{ 
  //char offset=43;
  char offset=30;
  
  
  int kol=0;
  char linia=0;
  char bit=0;
  char ill_znak=0;

   
  char dlugosc=0;
  char clean_offset=0;
  
 
    do {   
       
       
       if (Vstring[ill_znak]>=offset)  
        {
          dlugosc += Arial_7[Vstring[ill_znak]-offset][0];
        }
       else
       {
         dlugosc++;
         dlugosc++;
         dlugosc++;
       }
       
       
       dlugosc++;
       ill_znak++;
     } while ((Vstring[ill_znak]) && (ill_znak<maxChar) && (dlugosc<=64));
    
  
    
  dlugosc--;
  
   
 return dlugosc;
  
}//_______________________ Koniec funkcji LabelLength __________________________








//*-----------------------------------------------------------------------------
//* Nazwa funkcji :    Label
//* Funkcja wrysowania napisu
//*-----------------------------------------------------------------------------
//*  Vstring    - wskaŸnik do tablicy znaków
//*  alig       - wyrównanie -0=do lewej, 1=do prawej, 2=wyœrodkowany
//*  X          - wspó³¿êdna X zale¿na od wyrównania 
//*  Y          - wspó³¿êdna Y do³u napisu
//*  maxChar    - maksymalna d³ugoœæ napisu w znakach 
//*  clean      - d³ugoœæ (w pikselach) obszaru czyszczenia t³a 
//*  minY, maxY - obszar roboczy
//*  negatyw    - 0-brak, 1-negatyw
//*-----------------------------------------------------------------------------

void Label20 (char *Vstring, char alig, char X, int Y, char maxChar, char clean, char minY, char maxY, char negatyw) 
{ 
  //char offset=43;
  char offset=30;
  
  
  int kol=0;
  char linia=0;
  char bit=0;
  char ill_znak=0;
  
  char pocz_X=X;
  
  kol=X/8;
  bit=X%8;
  linia=Y;
   
  char dlugosc=0;
  char clean_offset=0;
  
  

  
  
  
  if (alig==1)
  {
    do {       
       
       if (Vstring[ill_znak]>=offset)  
        {
          dlugosc += Arial_18[Vstring[ill_znak]-offset][0];
        }
       else
       {
         dlugosc++;
         dlugosc++;
         dlugosc++;
       }
       dlugosc++;
       ill_znak++;
      } while ((Vstring[ill_znak]) && (ill_znak<maxChar) && (X-dlugosc>=0) );
 
    clean_offset=clean;
  }
  else
  {
    do {   
       
       
       if (Vstring[ill_znak]>=offset)  
        {
          dlugosc += Arial_18[Vstring[ill_znak]-offset][0];
        }
       else
       {
         dlugosc++;
         dlugosc++;
         dlugosc++;
       }
       
       
       dlugosc++;
       ill_znak++;
     } while ((Vstring[ill_znak]) && (ill_znak<maxChar) && (X+dlugosc<=64));
    
  }
    
  dlugosc--;
  
   //Czyszczenie obszaru ----------------------
  linia=Y;
  for (int i=1; i<=25; i++)
   {
    if ((linia>=minY) && (linia<=maxY))
    {
     kol=(X-clean_offset)/8;
     bit=(X-clean_offset)%8;
       
      for (int j=0; j<=clean; j++)
      {
        LCD_Canvas[kol][linia] &=~(1<<bit);
        
        if (bit<7) { bit++;} else {bit=0;  kol++; }
      }   


   }
    linia++;
  }
  //------------------------------------------------------
    
  if (alig==1)
  {  
    X-=dlugosc;
  }  
 
  if (alig==2)
  {  
    X+=(clean-dlugosc)/2;
    
    if (((clean-dlugosc)%2)>0) X++;
  }  

    
  //wklejanie napisu do LCD_Canvas ----------------------
  linia=Y;
  for (int i=1; i<=25; i++)
   {
    if ((linia>=minY) && (linia<=maxY))
    {
     kol=X/8;
     bit=X%8;
    for (int k=0; k<=(ill_znak-1); k++)
    {     
      
      if ((Vstring[k]>=offset) &&  (Vstring[k]!=32))
      {
        for (int j=0; j<=Arial_18[Vstring[k]-offset][0]; j++)
        {
            LCD_Canvas[kol][linia] |= (((Arial_18[Vstring[k]-offset][i])>>j)&0x1)<<bit;
            if (bit<7) { bit++;} else {bit=0;  kol++; } 
        }
      }
      else 
      {
           if (bit<7) { bit++;} else {bit=0;  kol++; } 
           if (bit<7) { bit++;} else {bit=0;  kol++; } 
           if (bit<7) { bit++;} else {bit=0;  kol++; } 

      }
      
      
    }
   }
    linia++;
  }
  //------------------------------------------------------
    

  //negatyw obszaru ----------------------
 if (negatyw)
 {
  linia=Y;
  for (int i=1; i<=9; i++)
   {
    if ((linia>=minY) && (linia<=maxY))
    {
     
     kol=(pocz_X-clean_offset)/8;
     bit=(pocz_X-clean_offset)%8;
       
      for (int j=0; j<=clean; j++)
      {
       
        if (((LCD_Canvas[kol][linia]>>bit)&0x1)>0)
        {
           LCD_Canvas[kol][linia] &=~(1<<bit);   
          
        }
        else
        {
          LCD_Canvas[kol][linia] |=(1<<bit); 
          
        }
        
        
        
        if (bit<7) { bit++;} else {bit=0;  kol++; }
      }   


   }
    linia++;
  }
  }
  //------------------------------------------------------
   

  
}//_______________________ Koniec funkcji Label __________________________









//*-----------------------------------------------------------------------------
//* Nazwa funkcji :    TimeToStr
//* Funkcja Czasu na string
//*-----------------------------------------------------------------------------
//*-----------------------------------------------------------------------------
void TimeToStr (char godz, char min, char sek, char Vstring[8]) 
{ 
       if (godz<10) 
       {
         Vstring[0]=48;
         Vstring[1]=godz+48;
       }
       else
       {
         Vstring[0]=godz/10+48;
         Vstring[1]=godz%10+48;
       }
       Vstring[2]=58;
       
       if (min<10) 
       {
         Vstring[3]=48;
         Vstring[4]=min+48;
       }
       else
       {
         Vstring[3]=min/10+48;
         Vstring[4]=min%10+48;
       }
       Vstring[5]=58;
       
       
       if (sek<10) 
       {
         Vstring[6]=48;
         Vstring[7]=sek+48;
       }
       else
       {
         Vstring[6]=sek/10+48;
         Vstring[7]=sek%10+48;
       }

       
}//_______________________ Koniec funkcji TimeToStr____________________________



//*-----------------------------------------------------------------------------
//* Nazwa funkcji :    DateToStr
//* Funkcja Daty na string
//*-----------------------------------------------------------------------------
//*-----------------------------------------------------------------------------
void DateToStr (char dzin, char mies, char rok, char Vstring[8]) 
{ 
       if (dzin<10) 
       {
         Vstring[0]=48;
         Vstring[1]=dzin+48;
       }
       else
       {
         Vstring[0]=dzin/10+48;
         Vstring[1]=dzin%10+48;
       }
       Vstring[2]=45; //"-"
       
       if (mies<10) 
       {
         Vstring[3]=48;
         Vstring[4]=mies+48;
       }
       else
       {
         Vstring[3]=mies/10+48;
         Vstring[4]=mies%10+48;
       }
       Vstring[5]=45; //"-"
       
       
       if (rok<10) 
       {
         Vstring[6]=48;
         Vstring[7]=rok+48;
       }
       else
       {
         Vstring[6]=rok/10+48;
         Vstring[7]=rok%10+48;
       }

       
}//_______________________ Koniec funkcji DateToStr ____________________________




//*-----------------------------------------------------------------------------
//* Nazwa funkcji :    CharToStr
//* Funkcja konwersji zmiennej float na ³añcuch string   
//*-----------------------------------------------------------------------------
//*  Value   - zmienna typu float
//*  Vstring - tablica znaków
//*  ill     - liloœæ znaków (max=9) , ostatnia wartoœæ zapisanego ³añcucha to zawsze 0
//* return   - iloœæ cyfr w stringu
//*-----------------------------------------------------------------------------
char CharToStr (char Value, char *Vstring, char ill) 
{ 
      char set=0;
      char dzies=0;
      char jedn=0;
      char ind;
      
      for (int i=0; i<ill; i++) Vstring[i]=0;
        
      
      set= Value/100;
      dzies= (Value%100)/10;
      jedn = Value- (set*100) - (dzies*10);
      
      if (ill==0) ill=1; 
      ill--;
       
      ind=0;
      if (set>0) 
      {
        Vstring[ind]=set+48;
        ind++;
      }
      if (set+dzies>0) 
      {
        Vstring[ind]=dzies+48;
        ind++;
      }
      Vstring[ind]=jedn+48;

      ind++;
      return ind;
      
       
}//_______________________ Koniec funkcji konwersji float na string ____________________________






//*-----------------------------------------------------------------------------
//* Nazwa funkcji :    CharToStr2
//* Funkcja konwersji zmiennej float na ³añcuch string  w formacie 00 
//*-----------------------------------------------------------------------------
//*  Value   - zmienna typu float
//*  Vstring - tablica znaków
//*-----------------------------------------------------------------------------
void CharToStr2 (char Value, char *Vstring) 
{ 
      char set=0;
      char dzies=0;
      char jedn=0;

      set= Value/100;
      dzies= (Value%100)/10;
      jedn = Value- (set*100) - (dzies*10);      
      
      Vstring[1]=jedn+48;
      Vstring[0]=dzies+48;        
}//_______________________ Koniec funkcji konwersji float na string ____________________________








//*-----------------------------------------------------------------------------
//* Nazwa funkcji :    CharToStr
//* Funkcja konwersji zmiennej char na ³añcuch znakowy string -2 elementowy   
//*-----------------------------------------------------------------------------
//*  Value   - zmienna typu float
//*  Vstring - tablica znaków
//*-----------------------------------------------------------------------------
void CharToStrData (char Value, char *Vstring) 
{ 

      
      for (int i=0; i<2; i++) Vstring[i]=0;
      
      Vstring[0]=(Value/10)+48;
      Vstring[1]=(Value%10)+48;

}//_______________________ Koniec funkcji konwersji char na string ____________________________





//*-----------------------------------------------------------------------------
//* Nazwa funkcji :    sIntToStr
//* Funkcja konwersji zmiennej short int na ³añcuch string  wed³óg schematu dla zmiennej analogowej systemu (-3276.8 + 3276.7)
//*-----------------------------------------------------------------------------
//*  Value   - zmienna typu float
//*  Vstring - tablica znaków
//* return   - iloœæ cyfr w stringu
//*-----------------------------------------------------------------------------
char sIntToStr (signed short int Value, char *Vstring) 
{ 
      char znak=0;
      char ind=0;
      if (Value<0) znak='-';
      
      short int ValueTmp=abs(Value);
      
      char wartosc[6];
      
      for (int i=0; i<5; i++) 
      {
        Vstring[i]=0;
        wartosc[i]=0;
      }
        
      
      wartosc[0]   = ValueTmp/10000;
      wartosc[1]   = (ValueTmp-(wartosc[0]*10000))/1000;
      wartosc[2]   = (ValueTmp-(wartosc[0]*10000)-(wartosc[1]*1000))/100;
      wartosc[3]   = (ValueTmp-(wartosc[0]*10000)-(wartosc[1]*1000)-(wartosc[2]*100))/10;
      wartosc[4]   = '.';
      wartosc[5]   = (ValueTmp-(wartosc[0]*10000)-(wartosc[1]*1000)-(wartosc[2]*100)-(wartosc[3]*10));
      
      char PP=0;
      for (char i=0; i<5; i++) 
        if ((wartosc[i]>0) && (PP==0)) 
        {
          if (wartosc[i]=='.') PP=i; else PP=i+1;
        
        }
      
      if ((PP==0) && (wartosc[5]==0))
      {
        ind=1;
        Vstring[0]='0';
      }
      else
      {
        if (znak) 
        {
          Vstring[ind++]='-';
        }
        if (PP>0)
        for (char i=PP-1; i<4; i++)
        {
          Vstring[ind]=48+wartosc[i];
          ind++;
        }
        
          Vstring[ind]='.';
          Vstring[++ind]=48+wartosc[5];
          ind++;
      }
      
      return ind;
      
       
}//_______________________ Koniec funkcji konwersji float na string ____________________________







//*-----------------------------------------------------------------------------
//* Nazwa funkcji :    FloToStr
//* Funkcja konwersji zmiennej float na ³añcuch string   
//*-----------------------------------------------------------------------------
//*  Value   - zmienna typu float
//*  Vstring - tablica znaków
//*  ill     - liloœæ znaków (max=9) , ostatnia wartoœæ zapisanego ³añcucha to zawsze 0
//*  Funkcja zwraca d³ugoœæ ³añcucha
//*-----------------------------------------------------------------------------
void HexToStr (int Value, char Vstring[8],char length) 
{ 
      length=length-1; 
      for (int i=0; i<=length; i++) Vstring[i]=0;
       
       for (int i=0; i<=length; i++)
       {
          Vstring[length-i]=((Value>>(4*i))&0xf)+48;  
          
          if (Vstring[length-i]>57) {Vstring[length-i]+=7;}

          
       }   
   
   
   
}//_______________________ Koniec funkcji konwersji float na string ____________________________










//*-----------------------------------------------------------------------------
//* Nazwa funkcji :    List_Paint
//* Funkcja rysowania listy
//*-----------------------------------------------------------------------------
//* name[7]   -  Nazwa listy
//* Rows      -  ilosc wierszy
//* RowWith   -  szerokosc wiersza
//* Y         -  odsuniecie od górnej krawêdzi
//* FormStyle -  rodzaj formy 0-zwyk³a 1..-coraz mniejsze
//* Algin     - wyrównanie 0-pion œrodek, poziom lowo, 1-pion góra, poziom lowo, 2 pion dó³, poziom lowo, 3-pion œrodek, poziom wyœrodkowanie
//* p1...p8   - nazwy kolejnych pól
//*-----------------------------------------------------------------------------

char RealRows;
char RowsPoz;
void List_Paint(char name[10], char Rows, char RowWith, char Y, char FormStyle, char Algin, __String p,...)
{
  
  
 va_list parg; 
 va_start( parg, p);// pocz¹tek pracy ze zmienn¹ list¹ parametrów 
char *par[20];
char idf=0;
par[0] =p;
while(idf<Rows) {par[++idf] = va_arg( parg, char*);} 
va_end(parg); 
  

  RealRows=Rows;
  if ((Rows>7) && (RowWith>13)) Rows=6;
  if ((Rows>8) && (RowWith<=13)) Rows=7;
  
  if (FormStyle<4) 
  {
    CleanCanvas();
  }
  else
  {
    //  HalfCleanCanvas();
    if (FormStyle)
    {     
      CleanCanvasArea(FormStyle-1, 127-(Y+18+(RowWith*Rows))-2, 62-2*FormStyle+4,(RowWith*Rows)+5,0);
    
    }
    else
    {
      CleanCanvasArea(0, 127-(18+(RowWith*Rows))+Y, 62,(RowWith*Rows),0);

    }
  }
  
   
  
 
  if (FormStyle==0)
  {
  char ekran_tab[8][18] = {
                  {255,1,255,255,255,255,255,255,255,255,255,255,255,255,255,255,254,252},
                  {255,0,255,255,255,255,255,255,255,255,255,255,255,255,255,255,255,255},
                  {255,0,255,255,255,255,255,255,255,255,255,255,255,255,255,255,255,255},
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                  {255,128,255,240,231,239,237,238,239,239,239,239,238,237,111,103,48,31}
                  };
    
    CopyToCanvasPoint((char *)ekran_tab,0,109-Y,64,18); 
    Label(name,0,2,114-Y,10,42,0,127,1);  //(char *Vstring, char alig, char X, int Y, char maxChar, char clean, char minY, char maxY, char negatyw) 
    
   } 
    
 if (Rows>0)
 {
    
    char napis1_Y=110-Y-(RowWith/2)-5;

    

    for (char i=0; i<=Rows-1; i++)
    {
       if (par[i+RowsPoz]>0)
       switch (Algin)
       {
          case 0: Label(par[i+RowsPoz],0,2+FormStyle,napis1_Y-RowWith*i,15,58-2*FormStyle,0,127,0);     break; //(char *Vstring, char alig, char X, int Y, char maxChar, char clean, char minY, char maxY, char negatyw) 
          case 1: Label(par[i+RowsPoz],0,2+FormStyle,110-Y-10-RowWith*i,15,58-2*FormStyle,0,127,0);     break; //(char *Vstring, char alig, char X, int Y, char maxChar, char clean, char minY, char maxY, char negatyw) 
          case 2: Label(par[i+RowsPoz],0,2+FormStyle,110-Y+1-RowWith*(i+1),15,58-2*FormStyle,0,127,0);  break; //(char *Vstring, char alig, char X, int Y, char maxChar, char clean, char minY, char maxY, char negatyw)   
          case 3: Label(par[i+RowsPoz],2,2+FormStyle,napis1_Y-RowWith*i,15,58-2*FormStyle,0,127,0);     break; //(char *Vstring, char alig, char X, int Y, char maxChar, char clean, char minY, char maxY, char negatyw) 
       }   
    }
    
    
    if (~FormStyle) H_line(2,127-(17)-Y,54,0); 
    
    V_line(62-FormStyle,127-(18+(Rows*RowWith))-Y,(Rows*RowWith),1);
    if (FormStyle)
    {
        V_line(63-FormStyle,127-(18+(Rows*RowWith))-Y,(Rows*RowWith)-2,1);
    }
    else
    {
        V_line(63-FormStyle,127-(18+(Rows*RowWith))-Y,(Rows*RowWith),1); 
    }
    
    V_line(FormStyle,127-(18+(Rows*RowWith))-Y,(Rows*RowWith),1);
    
    if (FormStyle) H_line(FormStyle,127-18-Y,63-2*FormStyle,1); 
    
    for (char i=18+RowWith; i<=18+(Rows*RowWith); i=i+RowWith)
    {
      H_line(1+FormStyle,127-i-Y,61-2*FormStyle,1); 
    }
    
    H_line(4+FormStyle,127-(18+(Rows*RowWith))-1-Y,60-(2*FormStyle),1); 
  
 
    if (RealRows!=Rows) //je¿eli wiêcej pozycji ni¿ na ekranie
    {
       char LabelButt1[2], LabelButt2[2];
       LabelButt1[1]=0; LabelButt2[1]=0;  //LabelButt1 -góra, LabelButt2-dó³
       LabelButt1[0]=30; LabelButt2[0]=31;
       
       if (RowsPoz==0)
       {
          Button(LabelButt2,0,127-(18+(Rows*RowWith))-1-Y-15,64,16); //(etykieta char poz_X , char poz_Y ,char width, char height) 
       } 
       if ((RowsPoz>0) && (RowsPoz<RealRows-Rows))
       {
         Button(LabelButt1,0,127-(18+(Rows*RowWith))-1-Y-15,32,16); //(etykieta ,char poz_X , char poz_Y ,char width, char height)
         Button(LabelButt2,32,127-(18+(Rows*RowWith))-1-Y-15,32,16); //(etykieta char poz_X , char poz_Y ,char width, char height) 
       }
       if ((RowsPoz>0) && (RowsPoz>=RealRows-Rows))
       {
         Button(LabelButt1,0,127-(18+(Rows*RowWith))-1-Y-15,64,16); //(etykieta ,char poz_X , char poz_Y ,char width, char height)
       }
       
      
    }
    
    
    
    //bar poziomy
    if (RealRows!=Rows)
    {
       char MaxPoz = 127-19;
       char MinPoz = 127-(18+(Rows*RowWith))-1-Y+2;
       char Zakres =MaxPoz-MinPoz;
       char DlOdc=RealRows-Rows;
       DlOdc=RealRows-Rows+1;
       DlOdc=Zakres/DlOdc;
       char poz=RowsPoz*DlOdc;
       poz=MaxPoz-poz-DlOdc;
       V_line (61, MinPoz,Zakres+1, 1);  //V_line (char X, int Y, char lenght, char typ) 
       V_line (62, poz,DlOdc, 0);  //V_line (char X, int Y, char lenght, char typ) 
    }
    
 }else{
   V_line(0,1,115,1); 
   V_line(63,0,115,1);
   V_line(62,0,115,1);
   H_line(0,1,63,1);
   H_line(4,0,59,1);
 }
    
}//_______________________ Koniec funkcji List_Paint __________________________



    





//*-----------------------------------------------------------------------------
//* Nazwa funkcji :    List_Event
//* Funkcja rysowania listy
//*-----------------------------------------------------------------------------
//* name[7]   -  Nazwa listy
//* Rows      -  ilosc wierszy
//* RowWith   -  szerokosc wiersza
//* Y         -  odsuniecie od górnej krawêdzi
//* p1...p8   - nazwy kolejnych pól
//*-----------------------------------------------------------------------------

int List_Event(int X_up, int Y_up, int X_down, int Y_down, char Rows, char RowWith, char FormStyle, char Y)
{
  static char SelectRow; 
  char podswietl=0;
  int ans = 0;
  char AnsDown;
   static char DownAction=0;
char Y_up_tmp=127-Y_up;

    static char Xdown=0;

  //zdarzenie typu down "X"
    if ((FormStyle==0) && (X_down>46) && (X_down<63) && (Y_down>112-Y) && (Y_down<127-Y))    //"X"
    {
      MenuPaint();
      H_line(49,114-Y,10,0);
      H_line(49,123-Y,10,0); 
      V_line(49,114-Y,10,0); 
      V_line(58,114-Y,10,0); 
      podswietl=1;

      DownAction=1;
      AnsDown=0xFF;
      
      if ((!(AT91C_IFLASH_MEM->Config.SoundOff)) && (Xdown==0)) {
        ButtonBipCounter=g_counter+8;
          AT91C_BASE_PIOA->PIO_SODR =SpeakerPin;
        } 
      Xdown=1;
      
    }
  
    
    if ((FormStyle==0) && (X_up>46) && (X_up<63) && (Y_up>112-Y) && (Y_up<127-Y))                    //"X"
    {
      RowsPoz=0;
      ans = -1;
            if ((!(AT91C_IFLASH_MEM->Config.SoundOff)) && (Xdown==1)) 
            {
              ButtonBipCounter=g_counter+8;
              AT91C_BASE_PIOA->PIO_SODR =SpeakerPin;
            } 
            Xdown=0;
    }  

    
    if (Rows>0)
    {


    if ((Rows>7) && (RowWith>13)) Rows=6;
    if ((Rows>8) && (RowWith<=13)) Rows=7;

  //zdarzenie typu down
    if ((X_down>FormStyle) && (X_down<63-FormStyle) && (Y_down>127-(17+(Rows*RowWith))-Y) && (Y_down<127-(17)-Y) && (RowWith))   
    {
      char Y_down_tmp=127-Y_down;
      MenuPaint();
      H_line(2+FormStyle,127-(  (((Y_down_tmp-18-Y) / RowWith)*RowWith)    +18+Y)-1,61-2*FormStyle,1);
      H_line(2+FormStyle,127-(  (((Y_down_tmp-18-Y) / RowWith)*RowWith)    +18+Y)-(RowWith-1),61-2*FormStyle,1);
      V_line(1+FormStyle,127-(  (((Y_down_tmp-18-Y) / RowWith)*RowWith)    +18+Y)-(RowWith-1),RowWith-1,1);
      V_line(61-FormStyle,127-(  (((Y_down_tmp-18-Y) / RowWith)*RowWith)    +18+Y)-(RowWith-2),RowWith-3,1);
      podswietl=1;
      DownAction=1;
      
      DownAction=1;
      AnsDown=((Y_down_tmp-18-Y) / RowWith)+1;
      
      //dzwiêk przyciœniêcia
          static char LastAnsD=-1;
          if ((AnsDown>=0) && (AnsDown!=LastAnsD))
          {
            if ((!(AT91C_IFLASH_MEM->Config.SoundOff))) {
                ButtonBipCounter=g_counter+8;
                AT91C_BASE_PIOA->PIO_SODR =SpeakerPin;
                
              } 
          }
          LastAnsD=AnsDown;
          Xdown=0;
      
 }
    


    
    
    
    if ((RowWith) &(X_up>3) && (X_up<59) && (Y_up<127-(  (((Y_up_tmp-18-Y) / RowWith)*RowWith)    +18+Y)-1) && (Y_up>127-(  (((Y_up_tmp-18-Y) / RowWith)*RowWith)    +18+Y)-(RowWith-1)))                        //ustawienia
    {
      ans=RowsPoz+((Y_up_tmp-18-Y) / RowWith)+1;
     // MenuPaint();
    }
    
    if ((FormStyle==0) && (X_up>46) && (X_up<63) && (Y_up>112-Y) && (Y_up<127-Y))                    //"X"
    {
      ans = -1;
   
    }   
    if ((podswietl==0)) MenuPaint();
    
    if (ans>RowsPoz+Rows) ans=0;  
 

    if ((AnsDown>0) && (SelectRow!=AnsDown))
    {
       SelectRow=AnsDown;
        
    }else if (ans<0)
    {
      SelectRow=0;
    }
    
    char Button1Action=0;
    char Button2Action=0;
    if (RealRows!=Rows) //je¿eli wiêcej pozycji ni¿ na ekranie
    {
       char LabelButt1[2], LabelButt2[2];
       LabelButt1[1]=0; LabelButt2[1]=0;
       LabelButt1[0]=30; LabelButt2[0]=31;
       //LabelButt1 -góra, LabelButt2-dó³
       if (RowsPoz==0)
       {
          Button2Action=Button(LabelButt2,0,127-(18+(Rows*RowWith))-1-Y-15,64,16); //(etykieta char poz_X , char poz_Y ,char width, char height) 
       } 
       if ((RowsPoz>0) && (RowsPoz<RealRows-Rows))
       {
         Button1Action=Button(LabelButt1,0,127-(18+(Rows*RowWith))-1-Y-15,32,16); //(etykieta ,char poz_X , char poz_Y ,char width, char height)
         Button2Action=Button(LabelButt2,32,127-(18+(Rows*RowWith))-1-Y-15,32,16); //(etykieta char poz_X , char poz_Y ,char width, char height) 
       }
       if ((RowsPoz>0) && (RowsPoz>=RealRows-Rows))
       {
         Button1Action=Button(LabelButt1,0,127-(18+(Rows*RowWith))-1-Y-15,64,16); //(etykieta ,char poz_X , char poz_Y ,char width, char height)
       }
    
       if (Button1Action==1) {RowsPoz--;  MenuPaint(); }
       if (Button2Action==1) {RowsPoz++;  MenuPaint(); }
    }
    
    }
    
   // if (ans>0) RowsPoz=0;
    static char LastAns=-1;
    if ((ans>=0) && (ans!=LastAns))
    {
      Xdown=0;
      if ((!(AT91C_IFLASH_MEM->Config.SoundOff))) {
        ButtonBipCounter=g_counter+8;
          AT91C_BASE_PIOA->PIO_SODR =SpeakerPin;
        } 
    }
    
    if ((X_up>0)|| (Y_up>0)) Xdown=0;
    LastAns=ans;
    return ans;
  
    
    
}//_______________________ Koniec funkcji List_Event __________________________




//*-----------------------------------------------------------------------------
//* Nazwa funkcji :    ScrollList_Paint
//* Funkcja rysowania listy
//*-----------------------------------------------------------------------------
//* name[7]   -  Nazwa listy
//* Size_scroll  -  wielkosc listy
//* poz   -1 -  poziome linie rozdzielaj¹ce

//*-----------------------------------------------------------------------------

void ScrollList_Paint(char name[15], int Size_scroll, int *_Suw_poz, char poz)
    {

       char ekran_tab[8][128] = {
                  {254,1,1,1,1,1,1,1,1,1,1,1,1,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3,254},
                  {255,0,0,0,0,0,0,0,0,0,0,0,0,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240,255},
                  {255,0,0,0,0,0,0,0,0,0,0,0,0,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255,255},
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                  {127,192,128,128,128,128,132,142,159,155,128,128,128,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127,63},
                  };
     
       
        char suwak[14] = {128,255,255,255,255,224,238,238,224,255,255,255,255,128};
        
        int Suw_poz_tmp;
        //rysowanie wskaŸnika po³o¿enia
        if (Size_scroll>50)
        {
            Suw_poz_tmp=98-(((*_Suw_poz)*67)/Size_scroll)-14;
    
            for (int i=(Suw_poz_tmp); i<=Suw_poz_tmp+13; i++)
            {
              ekran_tab[7][i]=suwak[i-Suw_poz_tmp];
            }
        }
        
        CopyToCanvas(ekran_tab);
        
        Label(name,0,15,116,15,46,0,127,1);  //(char *Vstring, char alig, char X, int Y, char maxChar, char clean, char minY, char maxY, char negatyw) 
        if ((poz) && (Size_scroll>50))
        {
          H_line(54,Suw_poz_tmp,9,0);
          H_line(54,Suw_poz_tmp+13,9,0);
          V_line(54,Suw_poz_tmp+1,12,1); 
          V_line(55,Suw_poz_tmp+1,12,1); 
        }
    
    }//_________________________________________________________________________





//*-----------------------------------------------------------------------------
//* Nazwa funkcji :    Ask_Paint
//* Funkcja rysowania listy
//*-----------------------------------------------------------------------------
//* name[7]   -  Nazwa listy
//* p1...p2   - nazwy kolejnych pól
//*-----------------------------------------------------------------------------
void Ask_Paint(char name[10], char p1[15], char p2[15])
{


    List_Paint(name,1,47,25,0,3," "); //(char name[7], char Rows, char RowWith, char Y, char FormStyle, char back, char p1[12], char p2[12] , char p3[12] , char p4[12] , char p5[12] , char p6[12] , char p7[12] , char p8[12])
       
    
   if (p1!="") Label(p1,2,2,71,15,59,0,127,0);  //(char *Vstring, char alig, char X, int Y, char maxChar, char clean, char minY, char maxY, char negatyw) 
   if (p2!="")  Label(p2,2,2,62,15,59,0,127,0);  //(char *Vstring, char alig, char X, int Y, char maxChar, char clean, char minY, char maxY, char negatyw) 
    Label(" ",2,2,53,15,59,0,127,0);  //(char *Vstring, char alig, char X, int Y, char maxChar, char clean, char minY, char maxY, char negatyw) 


    
    char ekran_tab[8][15] = {
                  {249,13,245,245,245,245,245,245,245,245,245,245,245,13,249},
                  {255,0,255,255,119,55,55,87,103,103,119,255,255,0,255},
                  {255,0,255,255,199,187,187,187,187,187,199,255,255,0,255},
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                  {207,216,215,215,215,215,215,215,215,215,215,215,215,216,207},
                  };
    
    CopyToCanvasPoint((char *)ekran_tab,0,40,64,15); 
    H_line(2,57,59,1); 
    
    
}//_______________________ Koniec funkcji Ask_Paint __________________________




//*-----------------------------------------------------------------------------
//* Nazwa funkcji :    List_Event
//* Funkcja rysowania listy
//*-----------------------------------------------------------------------------
//* name[7]   -  Nazwa listy
//* Rows      -  ilosc wierszy
//* RowWith   -  szerokosc wiersza
//* Y         -  odsuniecie od górnej krawêdzi
//* p1...p8   - nazwy kolejnych pól
//*-----------------------------------------------------------------------------
int Ask_Event(int X_up, int Y_up, int X_down, int Y_down)
{
  char Y=25;
  
  char podswietl=0;
  int ans = 0;
  



  
  //zdarzenie typu down 
    for (char i=0; i<=30; i=i+30)
    {
  
        if ((X_down>2+i) && (X_down<51+i) &&  (Y_down>38) && (Y_down<55))   
        {  
          //MenuPaint();
          H_line(4+i,41,26,1);
          H_line(4+i,53,26,1);
          V_line(3+i,41,12,1);
          V_line(29+i,42,13,1);
          podswietl=1;
        }
    }

 
  //zdarzenie typu down "X"
    if ((X_down>46) && (X_down<63) && (Y_down>112-Y) && (Y_down<127-Y))    //"X"
    {
      //MenuPaint();
      H_line(49,114-Y,10,0);
      H_line(49,123-Y,10,0); 
      V_line(49,114-Y,10,0); 
      V_line(58,114-Y,10,0); 
      podswietl=1;
    }
  
    
    if ((X_up>46) && (X_up<63) && (Y_up>112-Y) && (Y_up<127-Y))                    //"X"
    {
      ans = -1;
    }  

    
      //zdarzenie typu down 
    for (char i=0; i<=1; i++)
    {
        if ((X_up>2+(i*30)) && (X_up<51+(i*30)) &&  (Y_up>38) && (Y_up<55))   
        {  
           ans=i+1;
        }
    }

   // if ((X_down>=0) && (X_down<64) && (podswietl==0)) {MenuPaint();}


    return ans;
  
}//_______________________ Koniec funkcji List_Event __________________________




//*-----------------------------------------------------------------------------
//* Nazwa funkcji :    Info_Paint
//* Funkcja info
//*-----------------------------------------------------------------------------
//* p1...p2   - nazwy kolejnych pól
//*-----------------------------------------------------------------------------
void Message(char p1[15], char p2[15], int MenuLevelJump)
{


    List_Paint("Info ",1,47,25,0,3,0,0,0,0,0,0,0,0); //(char name[7], char Rows, char RowWith, char Y, char FormStyle, char back, char p1[12], char p2[12] , char p3[12] , char p4[12] , char p5[12] , char p6[12] , char p7[12] , char p8[12])
       
    
   if (p1!="")  Label(p1,2,2,71,15,59,0,127,0);  //(char *Vstring, char alig, char X, int Y, char maxChar, char clean, char minY, char maxY, char negatyw) 
   if (p2!="")  Label(p2,2,2,62,15,59,0,127,0);  //(char *Vstring, char alig, char X, int Y, char maxChar, char clean, char minY, char maxY, char negatyw) 
    Label(" ",2,2,53,15,59,0,127,0);  //(char *Vstring, char alig, char X, int Y, char maxChar, char clean, char minY, char maxY, char negatyw) 
    H_line(2,57,59,1); 
   
    if (Button("Ok ",12,40,40,15))
    {
      MenuLevel=MenuLevelJump;
      MenuPaint();
    }
    
    
}//_______________________ Koniec funkcji Info_Paint __________________________




//*-----------------------------------------------------------------------------
//* Nazwa funkcji :    List_Paint
//* Funkcja rysowania listy
//*-----------------------------------------------------------------------------
//* name[7]   -  Nazwa listy
//* Rows      -  ilosc wierszy
//* RowWith   -  szerokosc wiersza
//* Y         -  odsuniecie od górnej krawêdzi
//* FormStyle -  rodzaj formy 0-zwyk³a 1..-coraz mniejsze
//* Algin     - wyrównanie 0-pion œrodek, poziom lowo, 1-pion góra, poziom lowo, 2 pion dó³, poziom lowo, 3-pion œrodek, poziom wyœrodkowanie
//* p1...p8   - nazwy kolejnych pól
//*-----------------------------------------------------------------------------
void Number_Paint(char name[10], char p1[1], char p2[1])
{
 
  CleanCanvas();

  char ekran_tab[8][128] = {
                  {254,255,3,249,5,245,245,245,245,245,245,245,245,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252,248},
                  {255,255,0,255,0,255,255,255,255,255,255,255,255,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255,255},
                  {255,255,0,7,136,139,139,139,139,139,139,139,139,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255,255},
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                  {127,255,192,159,160,175,175,175,175,175,175,175,175,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48,31},
                  };
    
    CopyToCanvas(ekran_tab);
    Label(name,0,2,116,10,42,0,127,1);  //(char *Vstring, char alig, char X, int Y, char maxChar, char clean, char minY, char maxY, char negatyw) 
    
 
    


    Label(p1,0,9,7,2,7,0,127,1);      //(char *Vstring, char alig, char X, int Y, char maxChar, char clean, char minY, char maxY, char negatyw) 
    Label(p2,0,51,7,2,7,0,127,1);    //(char *Vstring, char alig, char X, int Y, char maxChar, char clean, char minY, char maxY, char negatyw) 
    
}//_______________________ Koniec funkcji List_Paint __________________________





//*-----------------------------------------------------------------------------
//* Nazwa funkcji :    Number_Event
//* Funkcja rysowania listy
//*-----------------------------------------------------------------------------
//* name[7]   -  Nazwa listy
//* Rows      -  ilosc wierszy
//* RowWith   -  szerokosc wiersza
//* Y         -  odsuniecie od górnej krawêdzi
//* p1...p8   - nazwy kolejnych pól
//*-----------------------------------------------------------------------------
int Number_Event(int X_up, int Y_up, int X_down, int Y_down)
{

  char podswietl=0;
  int ans = 0;
  char kol = 0;
  char row = 0;
  


  //zdarzenie typu down (najechanie na przycisk)
  if ((X_down>1) && (X_down<62) && (Y_down>3) && (Y_down<81) && (X_down!=21) && (X_down!=42) && (Y_down!=61) && (Y_down!=41) && (Y_down!=21) )   
    {
      kol = (((X_down-1)/21))*21;
      row = (((Y_down-3)/20))*20;
      
      MenuPaint();   
      
      H_line(kol+3, row+4, 16,1);
      H_line(kol+3, row+19, 16,1);
      V_line(kol+3, row+4, 16,1);
      V_line(kol+18, row+4, 16,1);
   
      podswietl=1;
    }
 

    
  //zdarzenie typu down "X"
    if ((X_down>46) && (X_down<63) && (Y_down>112) && (Y_down<127))    //"X"
    {
      MenuPaint();
      H_line(49,115,10,0);
      H_line(49,124,10,0); 
      V_line(49,115,10,0); 
      V_line(58,115,10,0); 
      podswietl=1;
    }
   
  
   //zdarzenie typu up (naciœniêcie na "X")
    if ( (X_up>46) && (X_up<63) && (Y_up>112) && (Y_up<127))                    //"X"
    {
      ans = -1;
    }  
  
  
    if ((X_up>1) && (X_up<62) && (Y_up>3) && (Y_up<81) && (X_up!=21) && (X_up!=42) && (Y_up!=61) && (Y_up!=41) && (Y_up!=21) )   
    {
      kol = (((X_up-1)/21)+1);
      row = 3-(((Y_up-3)/20));

      ans=(row*3)+kol;
      
      if ((!(AT91C_IFLASH_MEM->Config.SoundOff)) && (AlarmOn==0)) {
        ButtonBipCounter=g_counter+8;
          AT91C_BASE_PIOA->PIO_SODR =SpeakerPin;
        } 
    }

  
    if ((X_down>=0) && (X_down<64) && (podswietl==0)) MenuPaint();

 

    return ans;
  
    
}//_______________________ Koniec funkcji List_Event __________________________









//*-----------------------------------------------------------------------------
//* Nazwa funkcji :    Message_Paint
//* Funkcja wiadomosci
//*-----------------------------------------------------------------------------
//* algin    - wyrównanie tekstu
//* p1..p3   -   napisy kolejnych lini

//*-----------------------------------------------------------------------------
extern  char g_Message;
void Message_Paint(char algin, char p1[15], char p2[15], char p3[15],char p4[15],char p5[15])
{
  g_Message=1;
  g_info=1;
  
  char ekran_tab[8][128] = {
                  {0,0,0,0,0,0,0,0,0,0,0,0,0,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0,0},
                  {0,0,0,0,0,0,0,0,0,0,0,0,0,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0,0},
                  {0,0,0,0,0,0,0,0,0,0,0,0,0,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0,0},
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                  {0,0,0,0,0,0,0,0,0,0,0,0,0,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0,0},
                  };
    
    CopyToCanvas(ekran_tab);


    if (p1!="") Label(p1,algin,4,90,15,56,0,127,0);      //(char *Vstring, char alig, char X, int Y, char maxChar, char clean, char minY, char maxY, char negatyw) 
    if (p2!="") Label(p2,algin,4,90-9,15,56,0,127,0);    //(char *Vstring, char alig, char X, int Y, char maxChar, char clean, char minY, char maxY, char negatyw) 
    if (p3!="") Label(p3,algin,4,90-18,15,56,0,127,0);    //(char *Vstring, char alig, char X, int Y, char maxChar, char clean, char minY, char maxY, char negatyw) 
    if (p4!="") Label(p4,algin,4,90-27,15,56,0,127,0);    //(char *Vstring, char alig, char X, int Y, char maxChar, char clean, char minY, char maxY, char negatyw) 
    if (p5!="") Label(p5,algin,4,90-36,15,56,0,127,0);    //(char *Vstring, char alig, char X, int Y, char maxChar, char clean, char minY, char maxY, char negatyw) 
    
    
}//_______________________ Koniec funkcji Mesage_Paint __________________________







//*-----------------------------------------------------------------------------
//* Nazwa funkcji :    FloToStr
//* Funkcja konwersji zmiennej float na ³añcuch string   
//*-----------------------------------------------------------------------------
//*  Value   - zmienna typu float
//*  Vstring - tablica znaków
//*  ill     - liloœæ znaków (max=9) , ostatnia wartoœæ zapisanego ³añcucha to zawsze 0
//*  Funkcja zwraca d³ugoœæ ³añcucha
//*-----------------------------------------------------------------------------
char FloToStr (float Value, char Vstring[8],char ill) 
{ 
  float str_tmp[15]={0,0,0,0,0,0,0,0,0,0,0,0,0,0,0};        
   int min;
   ill-=1;
  
   for (char i=0; i<=7; i++)  Vstring[i]=0;
   for (char i=0; i<=14; i++)  str_tmp[i]=0;
   
   min=0;
   if (Value<0)
   {
     Value=Value*(-1); 
     min=1;
     ill-=1;
   }
   
 
   int E_tmp=0;
   int ill_tmp=0;
   int ill_cor=0;
   
   
   if (Value==0)
   {
     Vstring[0]=48;
     ill_tmp=1;
   }
   else
   {
    if (Value>=1000000000000) 
    {
       Vstring[0]=0x4C; //L
       Vstring[1]=0x4F; //O
       Vstring[2]=0x4E; //N
       Vstring[3]=0x47; //G
       Vstring[4]=0; Vstring[5]=0; Vstring[6]=0; Vstring[7]=0;
    }  
    else 
    {  
      long long int __Value=(long long int)(Value*1000000);
      long long int __ValueRST=__Value;
      long long int NastDiel=0;
     
       if (Value>=100000000000 ) {if (E_tmp==0) E_tmp=12;     if (ill_tmp<ill)                   { ill_tmp++;  str_tmp[ill_tmp]=48+__Value    / 100000000000000000; __ValueRST=__Value    % 100000000000000000; }};
       if (Value>=10000000000  ) {if (E_tmp==0) E_tmp=11;     if (ill_tmp<ill)                   { ill_tmp++;  str_tmp[ill_tmp]=48+__ValueRST / 10000000000000000 ; __ValueRST=__ValueRST % 10000000000000000 ; }};
       if (Value>=1000000000   ) {if (E_tmp==0) E_tmp=10;     if (ill_tmp<ill)                   { ill_tmp++;  str_tmp[ill_tmp]=48+__ValueRST / 1000000000000000  ; __ValueRST=__ValueRST % 1000000000000000  ; }};
       if (Value>=100000000    ) {if (E_tmp==0) E_tmp=9;      if (ill_tmp<ill)                   { ill_tmp++;  str_tmp[ill_tmp]=48+__ValueRST / 100000000000000   ; __ValueRST=__ValueRST % 100000000000000   ; }};
       if (Value>=10000000     ) {if (E_tmp==0) E_tmp=8;      if (ill_tmp<ill)                   { ill_tmp++;  str_tmp[ill_tmp]=48+__ValueRST / 10000000000000    ; __ValueRST=__ValueRST % 10000000000000    ; }};
       if (Value>=1000000      ) {if (E_tmp==0) E_tmp=7;      if (ill_tmp<ill)                   { ill_tmp++;  str_tmp[ill_tmp]=48+__ValueRST / 1000000000000     ; __ValueRST=__ValueRST % 1000000000000     ; NastDiel=100000000000; }};
       if (Value>=100000       ) {if (E_tmp==0) E_tmp=6;      if (ill_tmp<ill)                   { ill_tmp++;  str_tmp[ill_tmp]=48+__ValueRST / 100000000000      ; __ValueRST=__ValueRST % 100000000000      ; NastDiel=10000000000 ; }};
       if (Value>=10000        ) {if (E_tmp==0) E_tmp=5;      if (ill_tmp<ill) { ill_tmp++;  str_tmp[ill_tmp]=48+__ValueRST / 10000000000       ; __ValueRST=__ValueRST % 10000000000       ; NastDiel=1000000000  ; }};
       if (Value>=1000         ) {if (E_tmp==0) E_tmp=4;      if (ill_tmp<ill) { ill_tmp++;  str_tmp[ill_tmp]=48+__ValueRST / 1000000000        ; __ValueRST=__ValueRST % 1000000000        ; NastDiel=100000000   ; }};
       if (Value>=100          ) {if (E_tmp==0) E_tmp=3;      if (ill_tmp<ill) { ill_tmp++;  str_tmp[ill_tmp]=48+__ValueRST / 100000000         ; __ValueRST=__ValueRST % 100000000         ; NastDiel=10000000    ; }};
       if (Value>=10           ) {if (E_tmp==0) E_tmp=2;      if (ill_tmp<ill) { ill_tmp++;  str_tmp[ill_tmp]=48+__ValueRST / 10000000          ; __ValueRST=__ValueRST % 10000000          ; NastDiel=1000000     ; }};
       if (Value>=1            ) {if (E_tmp==0) E_tmp=1;      if (ill_tmp<ill) { ill_tmp++;  str_tmp[ill_tmp]=48+__ValueRST / 1000000           ; __ValueRST=__ValueRST % 1000000           ; NastDiel=100000      ; }};
       if (Value>=0.09999      ) {if (E_tmp==0) E_tmp=100;    if ((ill_tmp<ill)&&(__ValueRST>0)) { ill_tmp++;  str_tmp[ill_tmp]=0x2E; ill_tmp++;  str_tmp[ill_tmp]=48+__ValueRST / 100000            ; __ValueRST=__ValueRST % 100000            ; NastDiel=10000; }};
       if (Value>=0.009999     ) {if (E_tmp==0) E_tmp=101;    if ((ill_tmp<ill)&&(__ValueRST>0)) { ill_tmp++;  str_tmp[ill_tmp]=48+(__ValueRST / 10000)           ; __ValueRST=__ValueRST % 10000             ; NastDiel=1000        ; }};
       if (Value>=0.0009999    ) {if (E_tmp==0) E_tmp=102;    if ((ill_tmp<ill)&&(__ValueRST>0)) { ill_tmp++;  str_tmp[ill_tmp]=48+(__ValueRST / 1000)            ; __ValueRST=__ValueRST % 1000              ; NastDiel=100         ; }};
       if (Value>=0.00009999   ) {if (E_tmp==0) E_tmp=103;    if ((ill_tmp<ill)&&(__ValueRST>0)) { ill_tmp++;  str_tmp[ill_tmp]=48+(__ValueRST / 100)             ; __ValueRST=__ValueRST % 100               ; NastDiel=10          ; }};
       if (Value>=0.000009999  ) {if (E_tmp==0) E_tmp=104;    if ((ill_tmp<ill)&&(__ValueRST>0)) { ill_tmp++;  str_tmp[ill_tmp]=48+(__ValueRST / 10)              ; __ValueRST=__ValueRST % 10                ; NastDiel=1           ; }};
       if (Value>=0.0000009999 ) {if (E_tmp==0) E_tmp=105;    if ((ill_tmp<ill)&&(__ValueRST>0)) { ill_tmp++;  str_tmp[ill_tmp]=48+(__ValueRST / 1)               ; __ValueRST=__ValueRST % 1                 ; NastDiel=0           ; }};
   
       if ((__ValueRST) && (NastDiel))
       {
         if (((__ValueRST/NastDiel)>5) && (str_tmp[ill_tmp]<57)) { str_tmp[ill_tmp]++; }
         if (((__ValueRST/NastDiel)>5) && (str_tmp[ill_tmp]==57)) 
            { 
              str_tmp[ill_tmp]=0;
              ill_cor++;
              if ((str_tmp[ill_tmp-1]>53) && (str_tmp[ill_tmp-1]<57) && ((ill_tmp-1)<1)  )
                { 
                  str_tmp[ill_tmp-1]++; 
                }
                if ((str_tmp[ill_tmp-1]==57) && ((ill_tmp-1)>0)  )
                {
                  ill_cor++;
                  str_tmp[ill_tmp-1]=0;
                  
                    if ((str_tmp[ill_tmp-2]>53) && (str_tmp[ill_tmp-2]<57) && ((ill_tmp-2)<1)  )
                    { 
                      str_tmp[ill_tmp-2]++; 
                    }
                  
                    if ((str_tmp[ill_tmp-2]==57) && ((ill_tmp-2)>0)  )
                    {
                        str_tmp[ill_tmp-2]=0;
                        if ((str_tmp[ill_tmp-3]>53) && (str_tmp[ill_tmp-3]<57) && ((ill_tmp-3)<1)  )
                        { 
                          ill_cor++;
                          str_tmp[ill_tmp-3]++; 
                        }
                        if ((str_tmp[ill_tmp-3]==57) && ((ill_tmp-3)>0)  )
                        {
                            str_tmp[ill_tmp-3]=0;
                            if ((str_tmp[ill_tmp-4]>53) && (str_tmp[ill_tmp-4]<57) && ((ill_tmp-4)<1)  )
                            { 
                              ill_cor++;
                  
                              str_tmp[ill_tmp-4]++; 
                            }
                            if ((str_tmp[ill_tmp-4]==57) && ((ill_tmp-4)>0)  )
                            {
                      
                              if ((str_tmp[ill_tmp-5]>53) && (str_tmp[ill_tmp-5]<57) && ((ill_tmp-5)<1)  )
                              { 
                                ill_cor++;
                                str_tmp[ill_tmp-4]=0;
                                str_tmp[ill_tmp-5]++; 
                              }
            
                            }
                        }
                           
                    }
                  
                  
                }
            }
       }
       

      
      if (ill_tmp-ill_cor) {ill_tmp-=ill_cor;} else {ill_tmp=0;}

      
      if (E_tmp<100) 
      {
        for (int i=0; i<=ill-1; i++) Vstring[min+i]=str_tmp[i+1];  
      }

      if ( E_tmp == 100 )
        {
          Vstring[min+0]=48;
          for (int i=1; i<=(E_tmp-100); i++) Vstring[min+i]=48; 
          for (int i=1+(E_tmp-100); i<=ill-1; i++) Vstring[min+i]=str_tmp[1+i-(1+(E_tmp-100))];  
        }
      if ( E_tmp > 100 )
        {
          Vstring[min+0]=48;
          Vstring[min+1]=46;
          for (int i=2; i<=(1+E_tmp-100); i++) Vstring[min+i]=48; 
          for (int i=2+(E_tmp-100); i<=ill-1; i++) {Vstring[min+i]=str_tmp[1+i-(2+(E_tmp-100))];  }

        }  
 
    
  
      if (NastDiel<=10000)
      {
        if ((Vstring[ill-1]==46)) 
          {
            Vstring[ill-1]=0;
          }
        if ((Vstring[ill-1]==48)) 
          {
            Vstring[ill-1]=0;
            ill_tmp--;
            if (Vstring[ill-2]==46)
            {
               Vstring[ill-2]=0;
               ill_tmp--; 
            }
            else
            {
                 if ((Vstring[ill-2]==48)) 
                 {
                    Vstring[ill-2]=0;
                    ill_tmp--;
                    if (Vstring[ill-3]==46)
                    {
                      Vstring[ill-3]=0;
                      ill_tmp--; 
                    }
                    else
                    {
                          if ((Vstring[ill-3]==48)) 
                          {
                            Vstring[ill-3]=0;
                            ill_tmp--;
                            if (Vstring[ill-4]==46)
                            {
                              Vstring[ill-4]=0;
                              ill_tmp--; 
                            }
                            else
                            {
                                if ((Vstring[ill-4]==48)) 
                                {
                                  Vstring[ill-4]=0;
                                  ill_tmp--;
                                  if (Vstring[ill-5]==46)
                                  {
                                    Vstring[ill-5]=0;
                                    ill_tmp--; 
                                  }
                                  else
                                  {
                                      if ((Vstring[ill-5]==48)) 
                                      {
                                        Vstring[ill-5]=0;
                                        ill_tmp--;
                                        if (Vstring[ill-6]==46)
                                        {
                                          Vstring[ill-6]=0;
                                          ill_tmp--; 
                                        }
                                        else
                                        {  
                                          if ((Vstring[ill-6]==48)) 
                                          {
                                            Vstring[ill-6]=0;
                                            ill_tmp--;
                                            if (Vstring[ill-7]==46)
                                            {
                                              Vstring[ill-7]=0;
                                              ill_tmp--; 
                                            }

                                          }
                                        }
                                       }
                                
                                
               
                                  }
                                }
                          
               
                            }
                          }  
               
                    }
                 }  
              
               
            }
        
          }
        
      }
      
    
      if ((E_tmp>ill) && (E_tmp<100))
      {
        if ((Vstring[ill-2]>53)&&(Vstring[ill-3]<57)) Vstring[ill-3]++;
        Vstring[ill-2]=0x45;
        Vstring[ill-1]=48+E_tmp-ill+2;
      }    
    
      if (min)
      {
        Vstring[0]=45; 
      }
      
      ill++;
      Vstring[ill+1]=0;
    
     }
   }

     
   return ill_tmp;


   
}//_______________________ Koniec funkcji konwersji float na string ____________________________






//*-----------------------------------------------------------------------------
//* Nazwa funkcji :    H_line
//* Funkcja rysowania lini poziomej
//*-----------------------------------------------------------------------------

//*  X          - wspó³¿êdna X zale¿na 
//*  Y          - wspó³¿êdna Y do³u napisu
//*  length     -d³ugoœæ
//*  typ        -0-bia³a 1=ci¹gla, 2=kropkowana, 3=kreskowana 
//*-----------------------------------------------------------------------------
void H_line (char X, int Y, char lenght, char typ) 
{ 
    int kol=0;
    char bit=0;
  
      kol=X/8;
      bit=X%8;
      
      for (int j=1; j<=lenght; j++)
      {
          
          if (typ>0) 
          {
            LCD_Canvas[kol][Y] |= (0x1)<<bit;
            if (bit<7) { bit++;} else {bit=0;  kol++; }
          }
          else
          {
              
              LCD_Canvas[kol][Y] &= ~((0x1)<<bit);
            if (bit<7) { bit++;} else {bit=0;  kol++; }
            
          }
         
          if ((typ==3) && ((j+1)<=lenght))
          {
            LCD_Canvas[kol][Y] |= (0x1)<<bit;
            if (bit<7) { bit++;} else {bit=0;  kol++;}
            j++;
          }
           if ((typ>=2) && ((j+1)<=lenght))
          {
            LCD_Canvas[kol][Y] &=~((0x1)<<bit);
            if (bit<7) { bit++;} else {bit=0;  kol++;}
            j++;
          }
          
      }   

}//_______________________ Koniec funkcji H_line ____________________________ 







//*-----------------------------------------------------------------------------
//* Nazwa funkcji :    V_line
//* Funkcja rysowania lini pionowej
//*-----------------------------------------------------------------------------

//*  X          - wspó³¿êdna X zale¿na 
//*  Y          - wspó³¿êdna Y do³u napisu
//*  length     -d³ugoœæ
//*  typ        -0-bia³a 1=ci¹gla, 2=kropkowana, 3=kreskowana 
//*-----------------------------------------------------------------------------
void V_line (char X, int Y, char lenght, char typ) 
{ 
    int kol=0;
    char bit=0;
  
      kol=X/8;
      bit=X%8;
      
      if (typ==1) 
      {
        for (int j=0; j<=lenght-1; j++)
        {
          LCD_Canvas[kol][Y+j] |= (0x1)<<bit;
        }
      }
      
      if (typ==2) 
      {
        char zmiana=0;
        for (int j=0; j<=lenght-1; j++)
        {
          if (zmiana==0)
          {
            LCD_Canvas[kol][Y+j] |= (0x1)<<bit;
            zmiana=1;
          }
          else
          {
            LCD_Canvas[kol][Y+j] &= ~((0x1)<<bit);
            zmiana=0;
          }
        }
      }
      
      if (typ==3) 
      {
        char zmiana=0;
        for (int j=0; j<=lenght-1; j++)
        {
          if (zmiana<2)
          {
            LCD_Canvas[kol][Y+j] |= (0x1)<<bit;
            zmiana++;
          }
          else
          {
            LCD_Canvas[kol][Y+j] &= ~((0x1)<<bit);
            zmiana=0;
          }
        }
      }
      
      
      if (typ==0) 
      {
         for (int j=0; j<=lenght-1; j++)
          {
          LCD_Canvas[kol][Y+j] &= ~((0x1)<<bit);
          }
        
      }


}//_______________________ Koniec funkcji H_line ____________________________ 



long long int ButtonEventTime=0;
//*-----------------------------------------------------------------------------
//* Nazwa funkcji :    Button
//* Uniwersalna funkcja przycisku
//*-----------------------------------------------------------------------------
//*  Label        - etykieta
//*  poz_X   - pozycja lewy róg
//*  poz_Y   - pozycja dolny róg
//*  width -   szerokoœæ
//*  height -  wysokoœæ
//*-----------------------------------------------------------------------------
long long ButtonBipCounter=0;

char Button (char _Label[15], char poz_X , char poz_Y ,char width, char height) 
{ 
    char odp =0;
    char tmpI=0;
    char tmpF=0;
    while ((tmpI<=15) && (tmpF==0))
    {
      if (_Label[tmpI]==0)
      {
        tmpF=1;
      }else{
        tmpI++;
      }
    }
    static char ButtonDown=0;
    CleanCanvasArea(poz_X+2, poz_Y+2, width-4, height-4,1);  //(char X, char Y, char X_Lenght, char Y_Lenght, char Type);   
    Label(_Label,2,poz_X+3,poz_Y+(height/2)-4,tmpI,width-7,1,127,1);  //(char *Vstring, char alig, char X, int Y, char maxChar, char clean, char minY, char maxY, negatyw) 
 


    if ( (X_down>poz_X) && (X_down<poz_X+width) && (Y_down>poz_Y+2) && (Y_down<poz_Y+height))
    {    
        H_line(poz_X+2,poz_Y+1,width-4,1); // (char X, int Y, char lenght, char typ) 
        H_line(poz_X+2,poz_Y+height-2,width-4,1); // (char X, int Y, char lenght, char typ) 
        V_line(poz_X+1,poz_Y+2,height-4,1); // (char X, int Y, char lenght, char typ) 
        V_line(poz_X+width-2,poz_Y+2,height-4,1); // (char X, int Y, char lenght, char typ) 
        odp=2;
        
        if ((ButtonDown==0) && (!(AT91C_IFLASH_MEM->Config.SoundOff))) {
          AT91C_BASE_PIOA->PIO_SODR =SpeakerPin;
          ButtonBipCounter=g_counter+8;
        } 
        ButtonDown=1;
    }
    else 
    {
        
      
       
        H_line(poz_X+2,poz_Y+1,width-4,0); // (char X, int Y, char lenght, char typ) 
        H_line(poz_X+2,poz_Y+height-2,width-4,0); // (char X, int Y, char lenght, char typ) 
        V_line(poz_X+1,poz_Y+2,height-4,0); // (char X, int Y, char lenght, char typ) 
        V_line(poz_X+width-2,poz_Y+2,height-4,0); // (char X, int Y, char lenght, char typ)   
       
        H_line(poz_X+1,poz_Y,width-2,1); // (char X, int Y, char lenght, char typ) 
        H_line(poz_X+1,poz_Y+height-1,width-2,1); // (char X, int Y, char lenght, char typ) 
        V_line(poz_X,poz_Y+1,height-2,1); // (char X, int Y, char lenght, char typ) 
        V_line(poz_X+width-1,poz_Y+1,height-2,1); // (char X, int Y, char lenght, char typ) 
    
        CanvasPixel(poz_X+1, poz_Y+1,1);   //(char X, char Y, char Colour)
        CanvasPixel(poz_X+width-2, poz_Y+1,1);   //(char X, char Y, char Colour)
        CanvasPixel(poz_X+1, poz_Y+height-2,1);   //(char X, char Y, char Colour)
        CanvasPixel(poz_X+width-2, poz_Y+height-2 ,1);   //(char X, char Y, char Colour)
        
        
        if ( (X_up>poz_X) && (X_up<poz_X+width) && (Y_up>poz_Y+2) && (Y_up<poz_Y+height))
        {    
          odp =1;
          ButtonDown=0;
        } 
          
          
    }
    

       
      ButtonEventTime=g_counter;
    
    return odp;
    
}






//*-----------------------------------------------------------------------------
//* Nazwa funkcji :    Zone
//* Uniwersalna funkcja przycisku strefy (przycisk bia³y)
//*-----------------------------------------------------------------------------
//*  Label        - etykieta
//*  poz_X   - pozycja lewy róg
//*  poz_Y   - pozycja dolny róg
//*  width -   szerokoœæ
//*  height -  wysokoœæ
//*  LineType- typ lini 0-bia³a 1=ci¹gla, 2=kropkowana, 3=kreskowana
//*-----------------------------------------------------------------------------
char Zone (char _Label[15], char poz_X , char poz_Y ,char width, char height, char LineType) 
{ 
    char odp =0;
    char tmpI=0;
    char tmpF=0;
    while ((tmpI<=15) && (tmpF==0))
    {
      if (_Label[tmpI]==0)
      {
        tmpF=1;
      }else{
        tmpI++;
      }
    }
    
    //CleanCanvasArea(poz_X+2, poz_Y+2, width-4, height-4,0);  //(char X, char Y, char X_Lenght, char Y_Lenght, char Type);   
    if (_Label!=0) Label(_Label,2,poz_X+3,poz_Y+(height/2)-4,tmpI,width-7,1,127,0);  //(char *Vstring, char alig, char X, int Y, char maxChar, char clean, char minY, char maxY, negatyw) 
 


    if ( (X_down>poz_X) && (X_down<poz_X+width) && (Y_down>poz_Y+2) && (Y_down<poz_Y+height))
    {    
        H_line(poz_X+2,poz_Y+1,width-4,1); // (char X, int Y, char lenght, char typ) 
        H_line(poz_X+2,poz_Y+height-2,width-4,1); // (char X, int Y, char lenght, char typ) 
        V_line(poz_X+1,poz_Y+2,height-4,1); // (char X, int Y, char lenght, char typ) 
        V_line(poz_X+width-2,poz_Y+2,height-4,1); // (char X, int Y, char lenght, char typ) 
        odp=2;
    }
    else 
    {
        
    
        H_line(poz_X+1,poz_Y,width-2,LineType); // (char X, int Y, char lenght, char typ) 
        H_line(poz_X+1,poz_Y+height-1,width-2,LineType); // (char X, int Y, char lenght, char typ) 
        V_line(poz_X,poz_Y+1,height-2,LineType); // (char X, int Y, char lenght, char typ) 
        V_line(poz_X+width-1,poz_Y+1,height-2,LineType); // (char X, int Y, char lenght, char typ) 
    

        
        if ( (X_up>poz_X) && (X_up<poz_X+width) && (Y_up>poz_Y+2) && (Y_up<poz_Y+height))
        {    
          odp =1;
        }
    }
    

       
      ButtonEventTime=g_counter;
    
    return odp;
    
}


 


//*-----------------------------------------------------------------------------
//* Nazwa funkcji :    List_Paint
//* Funkcja rysowania listy
//*-----------------------------------------------------------------------------
//* X1
//* Y1
//* X2
//* Y2
//* p - solid
//*-----------------------------------------------------------------------------


void Rectangle(char X1,char Y1,char Width,char Height,...)
{
  
 va_list parg; 
 va_start( parg, Height);// pocz¹tek pracy ze zmienn¹ list¹ parametrów 
 char SO;
 SO = va_arg( parg, char);
 va_end(parg); 
  


   H_line(X1,Y1,Width,1);
   H_line(X1,Y1+Height-1,Width,1);
   V_line(X1,Y1,Height,1);
   V_line(X1+Width-1,Y1,Height,1);
              
   //if (SO==1) CleanCanvasArea(X1,Y1,Width,Height,1);
   
}
 
 
//*-----------------------------------------------------------------------------
//* Nazwa funkcji :    CheckLCD
//* Funkcja sprawdza kolejne porty LCD
//*-----------------------------------------------------------------------------
//*-----------------------------------------------------------------------------

void CheckLCD(void)
 {
   m_pPio->PIO_SODR =  LCD_BUS_MASK;                         // zeruje piny
 
   
   AT91C_BASE_PIOA->PIO_CODR = DI; AT91C_BASE_PIOA->PIO_SODR = DI; 
   AT91C_BASE_PIOA->PIO_CODR = ENABLE; AT91C_BASE_PIOA->PIO_SODR = ENABLE; 
   AT91C_BASE_PIOA->PIO_CODR = DB0; AT91C_BASE_PIOA->PIO_SODR = DB0; 
   AT91C_BASE_PIOA->PIO_CODR = DB1; AT91C_BASE_PIOA->PIO_SODR = DB1; 
   AT91C_BASE_PIOA->PIO_CODR = DB2; AT91C_BASE_PIOA->PIO_SODR = DB2; 
   AT91C_BASE_PIOA->PIO_CODR = DB3; AT91C_BASE_PIOA->PIO_SODR = DB3; 
   AT91C_BASE_PIOA->PIO_CODR = DB4; AT91C_BASE_PIOA->PIO_SODR = DB4; 
   AT91C_BASE_PIOA->PIO_CODR = DB5; AT91C_BASE_PIOA->PIO_SODR = DB5; 
   AT91C_BASE_PIOA->PIO_CODR = DB6; AT91C_BASE_PIOA->PIO_SODR = DB6; 
   AT91C_BASE_PIOA->PIO_CODR = DB7; AT91C_BASE_PIOA->PIO_SODR = DB7; 
   AT91C_BASE_PIOA->PIO_CODR = CS1; AT91C_BASE_PIOA->PIO_SODR = CS1; 
   AT91C_BASE_PIOA->PIO_CODR = CS2; AT91C_BASE_PIOA->PIO_SODR = CS2; 
   AT91C_BASE_PIOA->PIO_CODR = (unsigned long)LightLCD; AT91C_BASE_PIOA->PIO_SODR = (unsigned long)LightLCD; 

  

}//_______________________ Koniec funkcji CheckLCD __________________________

 
  _TPoint Up, Down;   

#define TouchAmount 4       //iloœæ pamiêtanych punktów dotyku   
void GetTouchPoint(signed short *Xd,signed short  *Yd, signed short *Xu, signed short  *Yu)
{

  static _TPoint TouchList[TouchAmount];                                        //lista FIFO wspó³¿êdnych


  for (char i=1; i<TouchAmount; i++)
  {
     TouchList[TouchAmount-i].x=TouchList[TouchAmount-i-1].x;
     TouchList[TouchAmount-i].y=TouchList[TouchAmount-i-1].y;
  }

  Down.x=-1;
  Down.y=-1;
  Up.x=-1;
  Up.y=-1;
    
  ReadTP(TouchList); 
  
  //je¿eli pomiar ci¹g³y dotkniêtego ekranu 
  if ((TouchList[0].x>0) && (TouchList[1].x>0) && (TouchList[2].x>0) &&(TouchList[3].x>0))  
  {
    Down.x=((TouchList[1].x) + (TouchList[2].x))/2;

    Down.y=((TouchList[1].y) + (TouchList[2].y))/2;
  }
  
  //je¿eli dotkniêto ekran
  if ((TouchList[0].x>0) && (TouchList[1].x>0) && (TouchList[2].x>0) &&(TouchList[3].x<=0))  
  {
    Down.x=((TouchList[0].x) + (TouchList[1].x))/2;

    Down.y=((TouchList[0].y) + (TouchList[1].y))/2;
    TouchList[2].x=Down.x;
    TouchList[2].x=Down.x;
  }

  //je¿eli puszczono ekran
  if ((TouchList[0].x<=0) && (TouchList[1].x>0) && (TouchList[2].x>0) &&(TouchList[3].x>0))  
  {
    Up.x=((TouchList[2].x) + (TouchList[3].x))/2;

    Up.y=((TouchList[2].y) + (TouchList[3].y))/2;
  }  
  
  if ((Down.x>0) && (Down.y>0))
  {
    Down.x=korekta_X.A*Down.x+korekta_X.B;
    Down.y=korekta_Y.A*Down.y+korekta_Y.B;
  }
  
  if ((Up.x>0) && (Up.y>0))
  { 
    Up.x=korekta_X.A*Up.x+korekta_X.B;
    Up.y=korekta_Y.A*Up.y+korekta_Y.B;
    /*
    for (char i=0; i<TouchAmount; i++)
      {
         TouchList[TouchAmount-i].x=0;
         TouchList[TouchAmount-i].y=0;
         
      }
         Down.x=0;
         Down.y=0;
         */
         
  }
  if ((korekta_X.B!=0) && (korekta_Y.B!=0))
  {
    if ((Down.x>64) || (Down.y>128)) {Down.x=-1; Down.y=-1;} 
    if ((Up.x>64) || (Up.y>128)) {Up.x=-1; Up.y=-1;} 
  }
  *Xd=Down.x;
  *Yd=Down.y;
  *Xu=Up.x;
  *Yu=Up.y;

}

#endif